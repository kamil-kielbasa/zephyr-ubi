## Kconfig
```kconfig
# Copyright (c) 2026 Kamil Kiełbasa
# SPDX-License-Identifier: MIT

menuconfig UBI
        bool "Unsorted Block Images (UBI)"
        select FLASH
        select FLASH_MAP
        select CRC
        select PSA_WANT_ALG_CMAC
        select PSA_WANT_ALG_HKDF
        select PSA_WANT_ALG_SHA_256
        select PSA_WANT_KEY_TYPE_AES
        select PSA_WANT_KEY_TYPE_DERIVE
        help
          Volume manager for raw flash. Maps logical erase blocks onto
          physical ones, spreads wear across the partition, survives power
          loss and authenticates its own metadata with AES-CMAC.

          UBI never encrypts or authenticates application data; only its own
          headers and volume table are protected.

if UBI

#
# What the device looks like.
#

config UBI_MAX_NR_OF_VOLUMES
        int "Maximum number of volumes"
        default 4
        range 1 64
        help
          The only size limit that does not follow from the partition itself:
          how many logical erase blocks exist is decided by the partition,
          but how many volumes they are divided into is a design choice of
          the application.

#
# How wear is spread. These two work together and are the ones worth tuning
# for a given part.
#

config UBI_WEAR_LEVELING_THRESHOLD
        int "Erase count spread that makes relocation worthwhile"
        default 256
        range 64 512
        help
          Two things at once, which is why there is one knob and not two.

          It decides when levelling has work: a block in use whose erase
          count is this far below the block it would be moved onto is worth
          moving, and ubi_device_get_info() reports how many such blocks
          there are.

          It also bounds which free block gets handed out. An ordinary write
          takes the most worn free block within this many erases of the least
          worn one; relocation reaches twice as far. Bounding both ends is
          what stops either the freshest or the most worn block from
          absorbing everything. Linux UBI bounds the same search with
          wl_free_max_diff, which is likewise twice its threshold.

          Lower levels wear more evenly at the cost of more copying.

config UBI_PROTECTION_CYCLES
        int "Erases a freshly handed out block is left alone for"
        default 64
        range 0 255
        help
          A block just handed out holds data the caller has only begun
          writing and may be about to replace, so moving it is wasted work.
          This is how long levelling keeps its hands off.

          Counted in erases anywhere on the device, not in time. Zero turns
          the protection off. The count lives in RAM, so an attach starts
          every block unprotected.

          Too small is the dangerous direction: the window has to outlast
          how often the hottest data is rewritten. Measured on a pool of worn
          blocks flooded with barely used ones, a window of 8 left every one
          of 4096 rewrites being carried off and doubled the erase count;
          16 and above stopped it dead. Linux uses 10, but its levelling
          threshold is 4096 against our 256, so it reaches for a block far
          less often.

#
# How often the application is consulted.
#

config UBI_STATE_CHECK_INTERVAL
        int "Flash writes between state checks"
        default 64
        range 1 1024
        help
          UBI counts every write it makes to the flash. Once this many have
          gone by, the state callback is consulted before the next operation
          that would write, so that a refusal can be honoured with nothing
          written.

          The callback is always consulted at the end of an attach; this only
          decides how often it is consulted afterwards, so that a long uptime
          is not a way around the check. It does no flash I/O, so a small
          number is cheap.

#
# What to pay for extra checking. Both cost throughput and neither changes
# what is written to the flash.
#

config UBI_VERIFY_ON_READ
        bool "Verify the VID header before every read"
        default n
        help
          Re-reads and authenticates the header on every ubi_leb_read().
          Headers are always verified during attach, so this only guards
          against tampering while the device is running, and it costs an
          extra flash read plus a CMAC on the hottest path.

config UBI_SELF_CHECKS
        bool "Check the library's own choices at runtime"
        default n
        help
          Which block UBI allocated and which one it moved data off cannot be
          seen from outside; the only evidence a caller gets is an erase
          counter that went up. This turns those decisions into statements
          the library checks against itself.

          Each check is a second pass over the block table, so it doubles the
          cost of a choice that is already the expensive part of an
          allocation. Meant for tests and for bringing up a new part, not for
          shipping.

module = UBI
module-str = ubi
source "subsys/logging/Kconfig.template.log_config"

endif # UBI
```

## tests/integration/testcase.yaml
```yaml
tests:
  # The stock simulator: 4 KiB pages, single-byte writes.
  ubi.integration:
    platform_allow:
      - native_sim
    tags:
      - ubi
    integration_platforms:
      - native_sim
  # Geometries of real parts, each with its own write granularity.
  ubi.integration.nrf5340:
    platform_allow:
      - native_sim
    tags:
      - ubi
    extra_args:
      - DTC_OVERLAY_FILE=native_sim/nrf5340_flash.overlay
  ubi.integration.stm32u5:
    platform_allow:
      - native_sim
    tags:
      - ubi
    extra_args:
      - DTC_OVERLAY_FILE=native_sim/stm32u5_flash.overlay
  ubi.integration.mx25r64:
    platform_allow:
      - native_sim
    tags:
      - ubi
    extra_args:
      - DTC_OVERLAY_FILE=native_sim/mx25r64_flash.overlay
  # Switches that change what the library does.
  ubi.integration.verify_on_read:
    platform_allow:
      - native_sim
    tags:
      - ubi
    extra_configs:
      - CONFIG_UBI_VERIFY_ON_READ=y
  ubi.integration.self_checks:
    platform_allow:
      - native_sim
    tags:
      - ubi
    extra_configs:
      - CONFIG_UBI_SELF_CHECKS=y
  # The ends of two ranges.
  ubi.integration.eager_state_check:
    platform_allow:
      - native_sim
    tags:
      - ubi
    extra_configs:
      - CONFIG_UBI_STATE_CHECK_INTERVAL=1
  ubi.integration.no_protection:
    platform_allow:
      - native_sim
    tags:
      - ubi
    extra_configs:
      - CONFIG_UBI_PROTECTION_CYCLES=0
  # The nRF5340 DK's MX25R64, all 8 MiB. Tests that need the simulator's
  # counters or injected faults are not built here.
  ubi.integration.hardware:
    platform_allow:
      - nrf5340dk/nrf5340/cpuapp
    tags:
      - ubi
    slow: true
    timeout: 7200
  ubi.integration.hardware.64k:
    platform_allow:
      - nrf5340dk/nrf5340/cpuapp
    tags:
      - ubi
    slow: true
    timeout: 7200
    extra_configs:
      - CONFIG_NORDIC_QSPI_NOR_FLASH_LAYOUT_PAGE_SIZE=65536
  ubi.integration.hardware.verify_on_read:
    platform_allow:
      - nrf5340dk/nrf5340/cpuapp
    tags:
      - ubi
    slow: true
    timeout: 7200
    extra_configs:
      - CONFIG_UBI_VERIFY_ON_READ=y
  ubi.integration.hardware.self_checks:
    platform_allow:
      - nrf5340dk/nrf5340/cpuapp
    tags:
      - ubi
    slow: true
    timeout: 7200
    extra_configs:
      - CONFIG_UBI_SELF_CHECKS=y
  ubi.integration.hardware.eager_state_check:
    platform_allow:
      - nrf5340dk/nrf5340/cpuapp
    tags:
      - ubi
    slow: true
    timeout: 7200
    extra_configs:
      - CONFIG_UBI_STATE_CHECK_INTERVAL=1
  ubi.integration.hardware.no_protection:
    platform_allow:
      - nrf5340dk/nrf5340/cpuapp
    tags:
      - ubi
    slow: true
    timeout: 7200
    extra_configs:
      - CONFIG_UBI_PROTECTION_CYCLES=0
```

## tests/unit/testcase.yaml
```yaml
tests:
  ubi.unit:
    platform_allow:
      - native_sim
      - native_sim/native/64
    tags:
      - ubi
    integration_platforms:
      - native_sim
```
