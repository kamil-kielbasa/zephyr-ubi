/*
 * Copyright (c) 2026 Kamil Kiełbasa
 * SPDX-License-Identifier: MIT
 *
 * native_sim with the geometry of the STM32U585 internal flash: 8 KiB pages,
 * 16 bytes per write. UBI gets 8 MiB of a flash grown to 16 MiB.
 *
 * A volume table record is 32 bytes, plus 24 per volume and a 16-byte MAC,
 * so only this width leaves records unaligned and reaches the rounding in
 * the record write.
 */

&flashcontroller0 {
	reg = <0x00000000 0x01000000>;
};

&flash0 {
	reg = <0x00000000 0x01000000>;
	erase-block-size = <8192>;
	write-block-size = <16>;

	partitions {
		ubi_partition: partition@100000 {
			label = "ubi-storage";
			reg = <0x00100000 0x00800000>;
		};
	};
};
