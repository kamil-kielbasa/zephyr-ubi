## CMakeLists.txt
```
# Copyright (c) 2026 Kamil Kiełbasa
# SPDX-License-Identifier: MIT

cmake_minimum_required(VERSION 3.20.0)
find_package(Zephyr REQUIRED HINTS $ENV{ZEPHYR_BASE})

project(ubi_integration)

include(${ZEPHYR_UBI_MODULE_DIR}/cmake/warnings.cmake)

target_sources(app PRIVATE
  ../common/forge.c
  ../common/partition.c
  ../common/suite.c
  ../common/table_copies.c
  src/test_attach.c
  src/test_concurrency.c
  src/test_contract.c
  src/test_integrity_block.c
  src/test_integrity_table.c
  src/test_leb.c
  src/test_leb_copies.c
  src/test_maintenance.c
  src/test_relocation.c
  src/test_trust.c
  src/test_volume.c
  src/test_volume_resize.c
  src/workload.c
)

# Reads the flash simulator's operation counters and injects its faults.
if(CONFIG_FLASH_SIMULATOR)
  target_sources(app PRIVATE
    ../common/flash_faults.c
    ../common/flash_shim.c
    ../common/flash_stats.c
    src/sweep.c
    src/test_cost.c
    src/test_erase_failure.c
    src/test_power_loss_device.c
    src/test_power_loss_leb.c
    src/test_write_failure.c
  )
endif()

# The on-flash layout and key derivation, for tests that forge blocks.
target_include_directories(app PRIVATE
  ${ZEPHYR_UBI_MODULE_DIR}/library
  ${CMAKE_CURRENT_SOURCE_DIR}/../common
)

ubi_target_warnings(app)
```

## prj.conf
```kconfig
CONFIG_ZTEST=y
CONFIG_UBI=y

CONFIG_FLASH=y
CONFIG_FLASH_MAP=y
CONFIG_FLASH_PAGE_LAYOUT=y

CONFIG_MBEDTLS=y
CONFIG_MBEDTLS_PSA_CRYPTO_C=y
CONFIG_ENTROPY_GENERATOR=y

# Handle and block tables; 2048 blocks of 4 KiB take about 17 KiB.
CONFIG_HEAP_MEM_POOL_SIZE=32768

CONFIG_UBI_MAX_NR_OF_VOLUMES=4

CONFIG_MAIN_STACK_SIZE=16384
CONFIG_ZTEST_STACK_SIZE=16384
CONFIG_LOG=y
CONFIG_UBI_LOG_LEVEL_WRN=y
```

## app.overlay
```dts
/*
 * Copyright (c) 2026 Kamil Kiełbasa
 * SPDX-License-Identifier: MIT
 *
 * The stock storage partition is four erase blocks, which is the bare
 * minimum UBI accepts and leaves nothing to observe. Widen it to 512 KiB so
 * that a scan has 128 blocks to walk, the same figure the design targets.
 */

&storage_partition {
	reg = <0x000fc000 0x00080000>;
};
```

## nrf5340.overlay
```dts
/*
 * Copyright (c) 2026 Kamil Kiełbasa
 * SPDX-License-Identifier: MIT
 *
 * The internal flash of an nRF5340: 4 KiB pages, 8 bytes per write. The
 * stock simulator writes single bytes, which is a luxury no part offers and
 * which leaves every alignment and padding path in the library dead.
 */

&flash0 {
        erase-block-size = <4096>;
        write-block-size = <8>;
};
```

## stm32u5.overlay
```dts
/*
 * Copyright (c) 2026 Kamil Kiełbasa
 * SPDX-License-Identifier: MIT
 *
 * The internal flash of an STM32U585: 8 KiB pages, 16 bytes per write.
 *
 * Sixteen matters on its own. A volume table record is 32 bytes plus 24 per
 * volume, so with anything that divides eight it is aligned by accident and
 * the rounding in ubi_volume_table_write() is never reached.
 */

&flash0 {
        erase-block-size = <8192>;
        write-block-size = <16>;
};
```

## boards/native_sim.overlay
```dts
/*
 * Copyright (c) 2026 Kamil Kiełbasa
 * SPDX-License-Identifier: MIT
 *
 * 8 MiB, the size of the nRF5340 DK's MX25R64, on a flash grown to 16 MiB.
 */

&flashcontroller0 {
	reg = <0x00000000 0x01000000>;
};

&flash0 {
	reg = <0x00000000 0x01000000>;

	partitions {
		ubi_partition: partition@100000 {
			label = "ubi-storage";
			reg = <0x00100000 0x00800000>;
		};
	};
};
```

## boards/nrf5340dk_nrf5340_cpuapp.overlay
```dts
/*
 * Copyright (c) 2026 Kamil Kiełbasa
 * SPDX-License-Identifier: MIT
 *
 * The whole MX25R64, 8 MiB. The DK gives it no partitions, and the label
 * storage_partition belongs to the internal flash.
 */

&mx25r64 {
	status = "okay";

	partitions {
		compatible = "fixed-partitions";
		#address-cells = <1>;
		#size-cells = <1>;

		ubi_partition: partition@0 {
			label = "ubi-storage";
			reg = <0x00000000 0x00800000>;
		};
	};
};
```

## src/main.c
```c
/**
 * \file    main.c
 * \author  Kamil Kielbasa
 * \brief   Integration tests for formatting and attaching.
 *
 *          Everything here goes through the public API and a simulated
 *          flash. The library carries no test hooks; where a test needs to
 *          see the flash it opens the partition itself, exactly as an
 *          attacker or a stray writer would.
 *
 * \copyright Copyright (c) 2026
 *
 */

/* Include files ----------------------------------------------------------- */

/* Standard library headers: */
#include <errno.h>
#include <string.h>

/* Zephyr headers: */
#include <zephyr/storage/flash_map.h>
#include <zephyr/sys/crc.h>
#include <zephyr/ztest.h>

/* PSA headers: */
#include <psa/crypto.h>

/* UBI headers: */
#include <ubi/ubi.h>

/* Module defines ---------------------------------------------------------- */

#define TEST_PARTITION FIXED_PARTITION_ID(storage_partition)

/** Chunk used when sweeping the whole partition. */
#define SWEEP_CHUNK (256)

/* Module variables and constants ------------------------------------------ */

static struct ubi_device *ubi;

static const uint8_t ikm_bytes[32] = {
	0x00, 0x01, 0x02, 0x03, 0x04, 0x05, 0x06, 0x07, 0x08, 0x09, 0x0A,
	0x0B, 0x0C, 0x0D, 0x0E, 0x0F, 0x10, 0x11, 0x12, 0x13, 0x14, 0x15,
	0x16, 0x17, 0x18, 0x19, 0x1A, 0x1B, 0x1C, 0x1D, 0x1E, 0x1F,
};

static psa_key_id_t key_right;
static psa_key_id_t key_wrong;

static struct ubi_config config;
static struct ubi_config config_wrong_key;

static uint32_t event_count;
static enum ubi_event_type last_event;
static bool event_seen[UBI_EVENT_PEB_BAD + 1];
static uint32_t state_check_count;
static struct ubi_device_info last_state;

/* Static function definitions --------------------------------------------- */

static enum ubi_state_verdict
trust_everything(const struct ubi_device_info *info, void *user_context)
{
	ARG_UNUSED(user_context);

	state_check_count += 1;
	last_state = *info;

	return UBI_STATE_TRUSTED;
}

static enum ubi_state_verdict trust_nothing(const struct ubi_device_info *info,
					    void *user_context)
{
	ARG_UNUSED(user_context);

	state_check_count += 1;
	last_state = *info;

	return UBI_STATE_UNTRUSTED;
}

static void on_event(const struct ubi_event *event, void *user_context)
{
	ARG_UNUSED(user_context);

	event_count += 1;
	last_event = event->type;
	event_seen[event->type] = true;
}

static psa_key_id_t import_ikm(const uint8_t *bytes, size_t length)
{
	psa_key_attributes_t attributes = PSA_KEY_ATTRIBUTES_INIT;
	psa_key_id_t key_id = PSA_KEY_ID_NULL;

	psa_set_key_type(&attributes, PSA_KEY_TYPE_DERIVE);
	psa_set_key_usage_flags(&attributes, PSA_KEY_USAGE_DERIVE);
	psa_set_key_algorithm(&attributes, PSA_ALG_HKDF(PSA_ALG_SHA_256));
	psa_set_key_lifetime(&attributes, PSA_KEY_LIFETIME_VOLATILE);

	zassert_equal(PSA_SUCCESS,
		      psa_import_key(&attributes, bytes, length, &key_id));

	return key_id;
}

/**
 * \brief Overwrite the whole partition with one byte value.
 */
static void partition_fill(uint8_t value)
{
	const struct flash_area *flash_area = NULL;
	uint8_t chunk[SWEEP_CHUNK];

	memset(chunk, value, sizeof(chunk));

	zassert_ok(flash_area_open(TEST_PARTITION, &flash_area));
	zassert_ok(flash_area_erase(flash_area, 0, flash_area->fa_size));

	if (0xFF != value) {
		for (off_t at = 0; at < (off_t)flash_area->fa_size;
		     at += sizeof(chunk)) {
			zassert_ok(flash_area_write(flash_area, at, chunk,
						    sizeof(chunk)));
		}
	}

	flash_area_close(flash_area);
}

/**
 * \brief Fingerprint the partition, so a test can prove nothing moved.
 */
static uint32_t partition_fingerprint(void)
{
	const struct flash_area *flash_area = NULL;
	uint8_t chunk[SWEEP_CHUNK];
	uint32_t crc = 0;

	zassert_ok(flash_area_open(TEST_PARTITION, &flash_area));

	for (off_t at = 0; at < (off_t)flash_area->fa_size;
	     at += sizeof(chunk)) {
		zassert_ok(
			flash_area_read(flash_area, at, chunk, sizeof(chunk)));
		crc = crc32_ieee_update(crc, chunk, sizeof(chunk));
	}

	flash_area_close(flash_area);

	return crc;
}

/**
 * \brief Flip one byte in the first \p copies volume table records found.
 *
 * \return How many records were reached.
 */
static uint32_t corrupt_volume_tables(uint32_t copies)
{
	const struct flash_area *flash_area = NULL;
	struct ubi_device_info info = { 0 };
	uint8_t byte = 0;
	uint32_t damaged = 0;

	zassert_ok(ubi_device_init(ubi, &config));
	zassert_ok(ubi_device_get_info(ubi, &info));
	zassert_ok(ubi_device_deinit(ubi));

	zassert_ok(flash_area_open(TEST_PARTITION, &flash_area));

	/* The record sits behind the two headers of whichever block holds it;
	 * clearing the lowest set bit is a write NOR always allows. */
	for (uint32_t pnum = 0; pnum < info.peb_count && damaged < copies;
	     ++pnum) {
		const off_t at = (off_t)pnum * info.peb_size + 128;

		zassert_ok(flash_area_read(flash_area, at, &byte, 1));

		if (0xFF != byte && 0x00 != byte) {
			byte &= (uint8_t)(byte - 1U);
			zassert_ok(flash_area_write(flash_area, at, &byte, 1));
			damaged += 1;
		}
	}

	flash_area_close(flash_area);

	return damaged;
}

static void *suite_setup(void)
{
	zassert_equal(PSA_SUCCESS, psa_crypto_init());

	key_right = import_ikm(ikm_bytes, sizeof(ikm_bytes));

	uint8_t other[sizeof(ikm_bytes)];

	memcpy(other, ikm_bytes, sizeof(other));
	other[0] ^= 0xFF;
	key_wrong = import_ikm(other, sizeof(other));

	config.flash_area_id = TEST_PARTITION;
	config.ikm_key_id = key_right;
	config.event_cb = on_event;
	config.state_cb = trust_everything;

	config_wrong_key = config;
	config_wrong_key.ikm_key_id = key_wrong;

	return NULL;
}

static void before_each(void *fixture)
{
	ARG_UNUSED(fixture);

	event_count = 0;
	state_check_count = 0;
	memset(event_seen, 0, sizeof(event_seen));
	memset(&last_state, 0, sizeof(last_state));

	ubi = k_malloc(ubi_device_size());
	zassert_not_null(ubi, "no memory for a device handle");
	memset(ubi, 0, ubi_device_size());

	partition_fill(0xFF);
}

static void after_each(void *fixture)
{
	ARG_UNUSED(fixture);

	k_free(ubi);
	ubi = NULL;
}

ZTEST_SUITE(ubi_integration, NULL, suite_setup, before_each, after_each, NULL);

/* Tests: recognising what is on the flash --------------------------------- */

ZTEST(ubi_integration, test_blank_partition_is_not_a_ubi_device)
{
	zassert_equal(-ENODEV, ubi_device_init(ubi, &config));
}

ZTEST(ubi_integration, test_foreign_content_is_not_a_ubi_device)
{
	partition_fill(0x5A);

	/* Refusing beats formatting: the bytes might be someone's data. */
	zassert_equal(-ENODEV, ubi_device_init(ubi, &config));
}

ZTEST(ubi_integration, test_format_then_attach)
{
	struct ubi_device_info info = { 0 };

	zassert_ok(ubi_device_format(&config));
	zassert_ok(ubi_device_init(ubi, &config));
	zassert_ok(ubi_device_get_info(ubi, &info));

	zassert_equal(128, info.peb_count);
	zassert_equal(4096, info.peb_size);
	zassert_equal(4096 - 128, info.leb_size,
		      "two headers precede the data");
	zassert_equal(1, info.write_block_size);
	zassert_equal(0, info.volume_count);
	zassert_not_equal(0, info.image_seq);
	zassert_equal(1, info.revision);
	zassert_equal(0, event_count, "a clean attach has nothing to report");

	zassert_ok(ubi_device_deinit(ubi));
}

ZTEST(ubi_integration, test_attach_survives_a_reboot)
{
	struct ubi_device_info first = { 0 };
	struct ubi_device_info second = { 0 };

	zassert_ok(ubi_device_format(&config));

	zassert_ok(ubi_device_init(ubi, &config));
	zassert_ok(ubi_device_get_info(ubi, &first));
	zassert_ok(ubi_device_deinit(ubi));

	/* Detaching and attaching again is what a reboot looks like. */
	zassert_ok(ubi_device_init(ubi, &config));
	zassert_ok(ubi_device_get_info(ubi, &second));
	zassert_ok(ubi_device_deinit(ubi));

	zassert_equal(first.image_seq, second.image_seq);
	zassert_equal(first.revision, second.revision);
	zassert_equal(first.global_sqnum, second.global_sqnum);
	zassert_equal(first.total_erase_count, second.total_erase_count);
	zassert_equal(first.healthy_pebs, second.healthy_pebs);
}

ZTEST(ubi_integration, test_reformatting_starts_a_new_image)
{
	struct ubi_device_info first = { 0 };
	struct ubi_device_info second = { 0 };

	zassert_ok(ubi_device_format(&config));
	zassert_ok(ubi_device_init(ubi, &config));
	zassert_ok(ubi_device_get_info(ubi, &first));
	zassert_ok(ubi_device_deinit(ubi));

	zassert_ok(ubi_device_format(&config));
	zassert_ok(ubi_device_init(ubi, &config));
	zassert_ok(ubi_device_get_info(ubi, &second));
	zassert_ok(ubi_device_deinit(ubi));

	zassert_not_equal(first.image_seq, second.image_seq,
			  "a reformat must not reuse the image sequence");
}

/* Tests: attach never damages the flash ----------------------------------- */

ZTEST(ubi_integration, test_a_wrong_key_is_refused_without_damage)
{
	uint32_t before = 0;
	uint32_t after = 0;

	zassert_ok(ubi_device_format(&config));

	before = partition_fingerprint();
	zassert_equal(-EBADMSG, ubi_device_init(ubi, &config_wrong_key));
	after = partition_fingerprint();

	zassert_equal(before, after,
		      "attach must not write, or a typo would destroy data");

	/* The right key still opens it afterwards. */
	zassert_ok(ubi_device_init(ubi, &config));
	zassert_ok(ubi_device_deinit(ubi));
}

ZTEST(ubi_integration, test_attach_leaves_the_flash_untouched)
{
	uint32_t before = 0;
	uint32_t after = 0;

	zassert_ok(ubi_device_format(&config));

	before = partition_fingerprint();
	zassert_ok(ubi_device_init(ubi, &config));
	zassert_ok(ubi_device_deinit(ubi));
	after = partition_fingerprint();

	zassert_equal(before, after);
}

ZTEST(ubi_integration, test_failed_attach_on_blank_flash_writes_nothing)
{
	const uint32_t before = partition_fingerprint();

	zassert_equal(-ENODEV, ubi_device_init(ubi, &config));

	zassert_equal(before, partition_fingerprint());
}

/* Tests: damaged and tampered metadata ------------------------------------ */

ZTEST(ubi_integration, test_one_damaged_volume_table_copy_is_survived)
{
	struct ubi_device_info before = { 0 };
	struct ubi_device_info after = { 0 };

	zassert_ok(ubi_device_format(&config));
	zassert_ok(ubi_device_init(ubi, &config));
	zassert_ok(ubi_device_get_info(ubi, &before));
	zassert_ok(ubi_device_deinit(ubi));

	zassert_equal(1, corrupt_volume_tables(1));

	/* This is what the second copy is for, but the device is now one
	 * erase away from losing a revision and has to say so. */
	zassert_ok(ubi_device_init(ubi, &config));
	zassert_ok(ubi_device_get_info(ubi, &after));
	zassert_ok(ubi_device_deinit(ubi));

	zassert_equal(before.image_seq, after.image_seq);
	zassert_equal(before.revision, after.revision);
	zassert_true(event_seen[UBI_EVENT_VOLUME_TABLE_DEGRADED]);
}

ZTEST(ubi_integration, test_both_damaged_volume_table_copies_lose_the_device)
{
	zassert_ok(ubi_device_format(&config));
	zassert_equal(2, corrupt_volume_tables(2));

	/*
	 * The record carries a checksum written before it, so a changed byte
	 * is indistinguishable from a write that never finished. Either way
	 * there is no usable volume table left, which is what attach reports.
	 */
	zassert_equal(-ENODEV, ubi_device_init(ubi, &config));
}

ZTEST(ubi_integration, test_erasing_every_stamped_block_loses_the_device)
{
	const struct flash_area *flash_area = NULL;
	struct ubi_device_info info = { 0 };

	zassert_ok(ubi_device_format(&config));
	zassert_ok(ubi_device_init(ubi, &config));
	zassert_ok(ubi_device_get_info(ubi, &info));
	zassert_ok(ubi_device_deinit(ubi));

	zassert_ok(flash_area_open(TEST_PARTITION, &flash_area));

	for (uint32_t pnum = 0; pnum < info.peb_count; ++pnum) {
		uint8_t magic[4] = { 0 };

		zassert_ok(flash_area_read(flash_area,
					   (off_t)pnum * info.peb_size, magic,
					   sizeof(magic)));

		if (0xFF == magic[0])
			continue;

		zassert_ok(flash_area_erase(flash_area,
					    (off_t)pnum * info.peb_size,
					    info.peb_size));
	}

	flash_area_close(flash_area);

	zassert_equal(-ENODEV, ubi_device_init(ubi, &config));
}

ZTEST(ubi_integration, test_a_damaged_erase_counter_header_is_reported)
{
	const struct flash_area *flash_area = NULL;
	struct ubi_device_info info = { 0 };
	uint8_t byte = 0;

	zassert_ok(ubi_device_format(&config));
	zassert_ok(ubi_device_init(ubi, &config));
	zassert_ok(ubi_device_get_info(ubi, &info));
	zassert_ok(ubi_device_deinit(ubi));

	zassert_ok(flash_area_open(TEST_PARTITION, &flash_area));

	/* A freshly stamped block has an erase count of one, so the last byte
	 * of that field has a bit NOR still allows clearing. */
	for (uint32_t pnum = 0; pnum < info.peb_count; ++pnum) {
		const off_t at = (off_t)pnum * info.peb_size + 0x0F;

		zassert_ok(flash_area_read(flash_area, at, &byte, 1));

		if (0x01 == byte) {
			byte = 0x00;
			zassert_ok(flash_area_write(flash_area, at, &byte, 1));
			break;
		}
	}

	flash_area_close(flash_area);

	event_count = 0;
	memset(event_seen, 0, sizeof(event_seen));

	/* The other copy carries the device through, but the damage is still
	 * reported. Nobody repaired the checksum, so it is damage rather than
	 * tampering. */
	zassert_ok(ubi_device_init(ubi, &config));
	zassert_true(event_seen[UBI_EVENT_HDR_CORRUPT]);
	zassert_true(event_seen[UBI_EVENT_VOLUME_TABLE_DEGRADED],
		     "one copy left has to be reported as such");
	zassert_false(event_seen[UBI_EVENT_HDR_TAMPERED]);

	zassert_ok(ubi_device_get_info(ubi, &info));
	zassert_equal(1, info.healthy_pebs, "the damaged block is not counted");

	zassert_ok(ubi_device_deinit(ubi));
}

/* Tests: the handle contract ---------------------------------------------- */

ZTEST(ubi_integration, test_attaching_twice_is_refused)
{
	zassert_ok(ubi_device_format(&config));
	zassert_ok(ubi_device_init(ubi, &config));

	zassert_equal(-EBUSY, ubi_device_init(ubi, &config));

	zassert_ok(ubi_device_deinit(ubi));
}

ZTEST(ubi_integration, test_a_detached_handle_answers_nothing)
{
	struct ubi_device_info info = { 0 };

	zassert_ok(ubi_device_format(&config));
	zassert_ok(ubi_device_init(ubi, &config));
	zassert_ok(ubi_device_deinit(ubi));

	zassert_equal(-EINVAL, ubi_device_get_info(ubi, &info));
	zassert_equal(-EINVAL, ubi_device_deinit(ubi));
}

ZTEST(ubi_integration, test_the_handle_has_a_size_the_caller_can_allocate)
{
	zassert_true(0 != ubi_device_size());
	zassert_true(sizeof(struct ubi_config) < ubi_device_size(),
		     "the handle holds rather more than the configuration");
}

/* Tests: rollback detection ----------------------------------------------- */

ZTEST(ubi_integration, test_the_rollback_counters_survive_a_reattach)
{
	struct ubi_device_info info = { 0 };

	zassert_ok(ubi_device_format(&config));
	zassert_ok(ubi_device_init(ubi, &config));
	zassert_ok(ubi_device_get_info(ubi, &info));
	zassert_ok(ubi_device_deinit(ubi));

	/* Only the two blocks holding the volume table have been stamped, and
	 * they carry the only sequence numbers issued so far. */
	zassert_equal(2, info.healthy_pebs);
	zassert_equal(2, info.total_erase_count);
	zassert_equal(2, info.global_sqnum);
	zassert_equal(1, info.revision);
}

ZTEST(ubi_integration, test_reformatting_does_not_restart_the_sequence_numbers)
{
	struct ubi_device_info first = { 0 };
	struct ubi_device_info second = { 0 };

	zassert_ok(ubi_device_format(&config));
	zassert_ok(ubi_device_init(ubi, &config));
	zassert_ok(ubi_device_get_info(ubi, &first));
	zassert_ok(ubi_device_deinit(ubi));

	zassert_ok(ubi_device_format(&config));
	zassert_ok(ubi_device_init(ubi, &config));
	zassert_ok(ubi_device_get_info(ubi, &second));
	zassert_ok(ubi_device_deinit(ubi));

	/*
	 * A format leaves most blocks untouched, so if it restarted the
	 * numbering a volume table left by the previous image would outrank
	 * the fresh one and the next attach would quietly undo the format.
	 */
	zassert_true(
		second.global_sqnum > first.global_sqnum,
		"a reformat must outrank whatever is already on the flash");
}

ZTEST(ubi_integration, test_reformatting_keeps_the_wear_history)
{
	struct ubi_device_info first = { 0 };
	struct ubi_device_info second = { 0 };

	zassert_ok(ubi_device_format(&config));
	zassert_ok(ubi_device_init(ubi, &config));
	zassert_ok(ubi_device_get_info(ubi, &first));
	zassert_ok(ubi_device_deinit(ubi));

	zassert_ok(ubi_device_format(&config));
	zassert_ok(ubi_device_init(ubi, &config));
	zassert_ok(ubi_device_get_info(ubi, &second));
	zassert_ok(ubi_device_deinit(ubi));

	/* A reformat reads the old erase count back and carries on from it,
	 * so the total never drops: that is what makes it usable as a
	 * rollback anchor. */
	zassert_true(second.total_erase_count > first.total_erase_count);
}

ZTEST(ubi_integration, test_the_state_check_sees_what_get_info_reports)
{
	struct ubi_device_info info = { 0 };

	zassert_ok(ubi_device_format(&config));
	zassert_ok(ubi_device_init(ubi, &config));
	zassert_ok(ubi_device_get_info(ubi, &info));

	zassert_equal(1, state_check_count, "an attach asks exactly once");
	zassert_equal(info.image_seq, last_state.image_seq);
	zassert_equal(info.global_sqnum, last_state.global_sqnum);
	zassert_equal(info.total_erase_count, last_state.total_erase_count);
	zassert_equal(info.healthy_pebs, last_state.healthy_pebs);

	zassert_ok(ubi_device_deinit(ubi));
}

ZTEST(ubi_integration, test_an_untrusted_state_stops_the_attach)
{
	struct ubi_config guarded = config;

	guarded.state_cb = trust_nothing;

	zassert_ok(ubi_device_format(&config));

	const uint32_t before = partition_fingerprint();

	zassert_equal(-EROFS, ubi_device_init(ubi, &guarded));
	zassert_equal(1, state_check_count);

	/* Refusing to trust the flash must not be a reason to change it. */
	zassert_equal(before, partition_fingerprint());

	zassert_ok(ubi_device_init(ubi, &config));
	zassert_ok(ubi_device_deinit(ubi));
}
```

## src/common.c
```c
/**
 * \file    common.c
 * \author  Kamil Kielbasa
 * \brief   Reaching the flash behind the library's back.
 *
 *          The library carries no test hooks; where a test needs to see or
 *          damage the flash it opens the partition itself, exactly as an
 *          attacker or a stray writer would.
 *
 * \copyright Copyright (c) 2026
 *
 */

/* Include files ----------------------------------------------------------- */

/* Standard library headers: */
#include <errno.h>
#include <string.h>

/* Zephyr headers: */
#include <zephyr/drivers/flash/flash_simulator.h>
#include <zephyr/stats/stats.h>
#include <zephyr/storage/flash_map.h>
#include <zephyr/sys/crc.h>
#include <zephyr/sys/util.h>
#include <zephyr/ztest.h>

/* UBI headers: */
#include <ubi/ubi.h>

#include "ubi_header.h"
#include "ubi_key.h"

/* Test headers: */
#include "common.h"

/* Module defines ---------------------------------------------------------- */

/** Chunk used when sweeping the whole partition. */
#define SWEEP_CHUNK (256)

/* Module type definitions ------------------------------------------------- */

/** One counter being looked for while walking the statistics group. */
struct counter_wanted {
	/** Name to match. */
	const char *name;
	/** What it held, left at zero when no name matched. */
	uint32_t value;
};

/* Module variables and constants ------------------------------------------ */

/** Bytes the injected write fault still lets through. */
static uint32_t writes_left;

/* Static function declarations -------------------------------------------- */

/**
 * \brief Find the next block whose data area starts with \p needle.
 *
 * \return Its offset, or -1 when there is no such block left.
 */
static off_t data_find(const struct flash_area *flash_area,
		       const uint8_t *needle, size_t length, off_t from);

/**
 * \brief Stand in for a worn out cell: refuse the write once the allowance
 *        set by \ref flash_fail_writes_after has run out.
 */
static int write_byte_fails(const struct device *dev, off_t offset,
			    uint8_t data);

/**
 * \brief Pick the wanted counter out of a statistics group being walked.
 */
static int counter_match(struct stats_hdr *group, void *arg, const char *name,
			 uint16_t offset);

/* Static function definitions --------------------------------------------- */

static int counter_match(struct stats_hdr *group, void *arg, const char *name,
			 uint16_t offset)
{
	struct counter_wanted *wanted = arg;

	if (0 == strcmp(wanted->name, name))
		wanted->value = *(uint32_t *)((uint8_t *)group + offset);

	return 0;
}

static off_t data_find(const struct flash_area *flash_area,
		       const uint8_t *needle, size_t length, off_t from)
{
	uint8_t chunk[SWEEP_CHUNK];
	const size_t compared = MIN(sizeof(chunk), length);

	for (off_t at = from; at < (off_t)flash_area->fa_size;
	     at += UBI_TEST_PEB_SIZE) {
		zassert_ok(flash_area_read(flash_area, at, chunk, compared));

		if (0 == memcmp(chunk, needle, compared))
			return at;
	}

	return -1;
}

static int write_byte_fails(const struct device *dev, off_t offset,
			    uint8_t data)
{
	ARG_UNUSED(dev);
	ARG_UNUSED(offset);

	if (0 == writes_left)
		return -EIO;

	writes_left -= 1;

	return data;
}

static const struct flash_simulator_cb failing_writes = {
	.write_byte = write_byte_fails,
};

/* Module interface function definitions ----------------------------------- */

void partition_fill(uint8_t value)
{
	const struct flash_area *flash_area = NULL;
	uint8_t chunk[SWEEP_CHUNK];

	memset(chunk, value, sizeof(chunk));

	zassert_ok(flash_area_open(TEST_PARTITION, &flash_area));
	zassert_ok(flash_area_erase(flash_area, 0, flash_area->fa_size));

	if (0xFF != value) {
		for (off_t at = 0; at < (off_t)flash_area->fa_size;
		     at += sizeof(chunk)) {
			zassert_ok(flash_area_write(flash_area, at, chunk,
						    sizeof(chunk)));
		}
	}

	flash_area_close(flash_area);
}

void stamp_erase_count(psa_key_id_t ikm_key_id, uint32_t pnum,
		       uint32_t image_seq, uint64_t erase_count)
{
	psa_key_id_t key_header = PSA_KEY_ID_NULL;
	psa_key_id_t key_volume_table = PSA_KEY_ID_NULL;
	uint8_t buffer[UBI_HEADER_SIZE];

	const struct ubi_ec_header header = {
		.erase_count = erase_count,
		.image_seq = image_seq,
		.vid_header_offset = UBI_TEST_VID_OFFSET,
		.data_offset = UBI_TEST_DATA_OFFSET,
	};

	zassert_ok(ubi_impl_key_derive(ikm_key_id, &key_header,
				       &key_volume_table));
	zassert_ok(ubi_impl_header_ec_serialize(&header, key_header, pnum,
						buffer, sizeof(buffer)));

	ubi_impl_key_destroy(&key_header);
	ubi_impl_key_destroy(&key_volume_table);

	const struct flash_area *flash_area = NULL;
	const off_t block = (off_t)pnum * UBI_TEST_PEB_SIZE;

	zassert_ok(flash_area_open(TEST_PARTITION, &flash_area));
	zassert_ok(flash_area_erase(flash_area, block, UBI_TEST_PEB_SIZE));
	zassert_ok(flash_area_write(flash_area, block, buffer, sizeof(buffer)));

	flash_area_close(flash_area);
}

void flash_clear_a_bit(const struct flash_area *flash_area, off_t at)
{
	const off_t block = ROUND_DOWN(at, UBI_TEST_WRITE_BLOCK);
	const size_t index = (size_t)(at - block);
	uint8_t buffer[UBI_TEST_WRITE_BLOCK];

	zassert_equal(UBI_TEST_WRITE_BLOCK, flash_area_align(flash_area),
		      "the overlay and the driver have to agree");
	zassert_ok(flash_area_read(flash_area, block, buffer, sizeof(buffer)));

	buffer[index] &= (uint8_t)(buffer[index] - 1U);

	/* The bytes around it go back bit for bit, which NOR always allows. */
	zassert_ok(flash_area_write(flash_area, block, buffer, sizeof(buffer)));
}

uint32_t partition_fingerprint(void)
{
	const struct flash_area *flash_area = NULL;
	uint8_t chunk[SWEEP_CHUNK];
	uint32_t crc = 0;

	zassert_ok(flash_area_open(TEST_PARTITION, &flash_area));

	for (off_t at = 0; at < (off_t)flash_area->fa_size;
	     at += sizeof(chunk)) {
		zassert_ok(
			flash_area_read(flash_area, at, chunk, sizeof(chunk)));
		crc = crc32_ieee_update(crc, chunk, sizeof(chunk));
	}

	flash_area_close(flash_area);

	return crc;
}

uint32_t corrupt_volume_tables(struct ubi_device *ubi,
			       const struct ubi_config *config, uint32_t copies)
{
	const struct flash_area *flash_area = NULL;
	struct ubi_device_info info = { 0 };
	uint8_t byte = 0;
	uint32_t damaged = 0;

	zassert_ok(ubi_device_init(ubi, config));
	zassert_ok(ubi_device_get_info(ubi, &info));
	zassert_ok(ubi_device_deinit(ubi));

	zassert_ok(flash_area_open(TEST_PARTITION, &flash_area));

	/* The record sits behind the two headers of whichever block holds it. */
	for (uint32_t pnum = 0; pnum < info.peb_count && damaged < copies;
	     ++pnum) {
		const off_t at = (off_t)pnum * info.peb_size + 128;

		zassert_ok(flash_area_read(flash_area, at, &byte, 1));

		if (0xFF != byte && 0x00 != byte) {
			flash_clear_a_bit(flash_area, at);
			damaged += 1;
		}
	}

	flash_area_close(flash_area);

	return damaged;
}

uint32_t count_data_matching(const uint8_t *needle, size_t length)
{
	const struct flash_area *flash_area = NULL;
	uint32_t found = 0;
	off_t at = UBI_TEST_DATA_OFFSET;

	zassert_ok(flash_area_open(TEST_PARTITION, &flash_area));

	while (0 <= (at = data_find(flash_area, needle, length, at))) {
		found += 1;
		at += UBI_TEST_PEB_SIZE;
	}

	flash_area_close(flash_area);

	return found;
}

uint32_t corrupt_data_matching(const uint8_t *needle, size_t length)
{
	const struct flash_area *flash_area = NULL;
	uint32_t damaged = 0;
	off_t at = UBI_TEST_DATA_OFFSET;

	zassert_ok(flash_area_open(TEST_PARTITION, &flash_area));

	while (0 <= (at = data_find(flash_area, needle, length, at))) {
		flash_clear_a_bit(flash_area, at);
		damaged += 1;
		at += UBI_TEST_PEB_SIZE;
	}

	flash_area_close(flash_area);

	return damaged;
}

uint32_t corrupt_header_of_data_matching(const uint8_t *needle, size_t length)
{
	const struct flash_area *flash_area = NULL;
	uint8_t header[UBI_TEST_DATA_OFFSET - UBI_TEST_VID_OFFSET];
	uint32_t damaged = 0;
	off_t at = UBI_TEST_DATA_OFFSET;

	zassert_ok(flash_area_open(TEST_PARTITION, &flash_area));

	while (0 <= (at = data_find(flash_area, needle, length, at))) {
		const off_t vid =
			at - UBI_TEST_DATA_OFFSET + UBI_TEST_VID_OFFSET;

		zassert_ok(flash_area_read(flash_area, vid, header,
					   sizeof(header)));

		/* Any byte with a bit left to clear will do: the checksum in
		 * front of the MAC covers the whole header. */
		for (size_t i = 0; i < sizeof(header); ++i) {
			if (0x00 == header[i])
				continue;

			flash_clear_a_bit(flash_area, vid + (off_t)i);
			damaged += 1;
			break;
		}

		at += UBI_TEST_PEB_SIZE;
	}

	flash_area_close(flash_area);

	return damaged;
}

void flash_fail_writes_after(uint32_t after)
{
	const struct flash_area *flash_area = NULL;

	zassert_ok(flash_area_open(TEST_PARTITION, &flash_area));

	writes_left = after;
	flash_simulator_set_callbacks(flash_area_get_device(flash_area),
				      &failing_writes);

	flash_area_close(flash_area);
}

void flash_fail_writes_never(void)
{
	const struct flash_area *flash_area = NULL;

	zassert_ok(flash_area_open(TEST_PARTITION, &flash_area));

	flash_simulator_set_callbacks(flash_area_get_device(flash_area), NULL);

	flash_area_close(flash_area);
}

uint32_t flash_ops(const char *name)
{
	struct stats_hdr *group = stats_group_find("flash_sim_stats");
	struct counter_wanted wanted = { .name = name, .value = 0 };

	zassert_not_null(group, "the flash simulator keeps no counters");
	zassert_ok(stats_walk(group, counter_match, &wanted));

	return wanted.value;
}

void flash_ops_forget(void)
{
	struct stats_hdr *group = stats_group_find("flash_sim_stats");

	zassert_not_null(group, "the flash simulator keeps no counters");
	stats_reset(group);
}
```

## src/common.h
```c
/**
 * \file    common.h
 * \author  Kamil Kielbasa
 * \brief   Reaching the flash behind the library's back.
 *
 * \copyright Copyright (c) 2026
 *
 */

/* Header guard ------------------------------------------------------------ */
#ifndef COMMON_H
#define COMMON_H

/* Include files ----------------------------------------------------------- */

/* Standard library headers: */
#include <stddef.h>
#include <stdint.h>

/* Zephyr headers: */
#include <zephyr/devicetree.h>
#include <zephyr/storage/flash_map.h>

/* PSA headers: */
#include <psa/crypto.h>

/* UBI headers: */
#include <ubi/ubi.h>

/* Defines ----------------------------------------------------------------- */

/** The partition every test formats, fills and inspects. */
#define TEST_PARTITION PARTITION_ID(storage_partition)

/** Where a block's data begins, behind its two 64-byte headers. */
#define UBI_TEST_DATA_OFFSET (128)

/** Where the volume identifier header begins, behind the erase counter one. */
#define UBI_TEST_VID_OFFSET (64)

/** Geometry of the flash this build runs on, straight from the overlay. */
#define UBI_TEST_PEB_SIZE DT_PROP(DT_NODELABEL(flash0), erase_block_size)
#define UBI_TEST_WRITE_BLOCK DT_PROP(DT_NODELABEL(flash0), write_block_size)

/* Function declarations --------------------------------------------------- */

/**
 * \brief Overwrite the whole partition with one byte value.
 */
void partition_fill(uint8_t value);

/**
 * \brief Erase a block and stamp it with an erase counter header of your own.
 *
 *        The header is sealed with the key the library would derive, so it
 *        verifies; only the count in it is a value the library would never
 *        write.
 *
 * \param ikm_key_id                   Keying material the device attaches with.
 * \param pnum                         Block to restamp.
 * \param image_seq                    Image the block should claim.
 * \param erase_count                  Count to write into the header.
 */
void stamp_erase_count(psa_key_id_t ikm_key_id, uint32_t pnum,
		       uint32_t image_seq, uint64_t erase_count);

/**
 * \brief Clear the lowest set bit of one byte on the flash.
 *
 *        The write goes out a whole write block at a time, because that is
 *        the smallest unit a real NOR part accepts, and the surrounding
 *        bytes go back unchanged.
 *
 * \param[in] flash_area                Open partition.
 * \param at                            Offset of the byte to damage.
 */
void flash_clear_a_bit(const struct flash_area *flash_area, off_t at);

/**
 * \brief Fingerprint the partition, so a test can prove nothing moved.
 */
uint32_t partition_fingerprint(void);

/**
 * \brief Flip one byte in the first \p copies volume table records found.
 *
 * \param[in,out] ubi                   Handle to attach with, left detached.
 * \param[in] config                    Configuration that reads them.
 * \param copies                        How many to damage.
 *
 * \return How many records were reached.
 */
uint32_t corrupt_volume_tables(struct ubi_device *ubi,
			       const struct ubi_config *config,
			       uint32_t copies);

/**
 * \brief Find a block whose data area starts with \p needle and flip a bit.
 *
 *        Stands in for a power loss between a sealed header and the last
 *        byte of the data it promises.
 *
 * \param[in] needle                    Bytes to look for.
 * \param length                        How many.
 *
 * \return How many blocks were changed.
 */
uint32_t corrupt_data_matching(const uint8_t *needle, size_t length);

/**
 * \brief Count the blocks whose data area starts with \p needle.
 *
 * \param[in] needle                    Bytes to look for.
 * \param length                        How many.
 *
 * \return How many blocks carry them.
 */
uint32_t count_data_matching(const uint8_t *needle, size_t length);

/**
 * \brief Flip a bit in the volume identifier header of every block whose
 *        data area starts with \p needle.
 *
 * \param[in] needle                    Bytes to look for.
 * \param length                        How many.
 *
 * \return How many headers were damaged.
 */
uint32_t corrupt_header_of_data_matching(const uint8_t *needle, size_t length);

/**
 * \brief Make every flash write past this one fail.
 *
 *        Stands in for a block that has worn out: the only fault the flash
 *        simulator cannot produce on its own.
 *
 * \param after                         Bytes to let through first.
 */
void flash_fail_writes_after(uint32_t after);

/**
 * \brief Let writes through again.
 */
void flash_fail_writes_never(void);

/**
 * \brief Read one of the flash simulator's counters.
 *
 * \param[in] name                      Counter to read, such as
 *                                      \c "flash_erase_calls".
 *
 * \return What it stands at.
 */
uint32_t flash_ops(const char *name);

/**
 * \brief Put every flash simulator counter back to zero.
 */
void flash_ops_forget(void);

#endif /* COMMON_H */
```

## src/suite.c
```c
/**
 * \file    suite.c
 * \author  Kamil Kielbasa
 * \brief   The integration suite: its keys, its handle and its lifecycle.
 *
 *          Every test starts from a blank partition and a zeroed handle, and
 *          none of them has to say so.
 *
 * \copyright Copyright (c) 2026
 *
 */

/* Include files ----------------------------------------------------------- */

/* Standard library headers: */
#include <stddef.h>
#include <string.h>

/* Zephyr headers: */
#include <zephyr/kernel.h>
#include <zephyr/ztest.h>

/* PSA headers: */
#include <psa/crypto.h>

/* UBI headers: */
#include <ubi/ubi.h>

/* Test headers: */
#include "common.h"
#include "suite.h"

/* Module variables and constants ------------------------------------------ */

struct ubi_device *ubi;

struct ubi_config config;
struct ubi_config config_wrong_key;

uint32_t event_count;
uint32_t event_seen[UBI_EVENT_PEB_BAD + 1];
struct ubi_event event_last[UBI_EVENT_PEB_BAD + 1];
uint32_t state_check_count;
struct ubi_device_info last_state;

static const uint8_t ikm_bytes[32] = {
	0x00, 0x01, 0x02, 0x03, 0x04, 0x05, 0x06, 0x07, 0x08, 0x09, 0x0A,
	0x0B, 0x0C, 0x0D, 0x0E, 0x0F, 0x10, 0x11, 0x12, 0x13, 0x14, 0x15,
	0x16, 0x17, 0x18, 0x19, 0x1A, 0x1B, 0x1C, 0x1D, 0x1E, 0x1F,
};

static psa_key_id_t key_right;
static psa_key_id_t key_wrong;

/* Static function declarations -------------------------------------------- */

/**
 * \brief Import keying material as a PSA derivation key.
 */
static psa_key_id_t import_ikm(const uint8_t *bytes, size_t length);

/**
 * \brief Event sink that only records what it was told.
 */
static void on_event(const struct ubi_event *event, void *user_context);

/* Static function definitions --------------------------------------------- */

static psa_key_id_t import_ikm(const uint8_t *bytes, size_t length)
{
	psa_key_attributes_t attributes = PSA_KEY_ATTRIBUTES_INIT;
	psa_key_id_t key_id = PSA_KEY_ID_NULL;

	psa_set_key_type(&attributes, PSA_KEY_TYPE_DERIVE);
	psa_set_key_usage_flags(&attributes, PSA_KEY_USAGE_DERIVE);
	psa_set_key_algorithm(&attributes, PSA_ALG_HKDF(PSA_ALG_SHA_256));
	psa_set_key_lifetime(&attributes, PSA_KEY_LIFETIME_VOLATILE);

	zassert_equal(PSA_SUCCESS,
		      psa_import_key(&attributes, bytes, length, &key_id));

	return key_id;
}

static void on_event(const struct ubi_event *event, void *user_context)
{
	ARG_UNUSED(user_context);

	event_count += 1;
	event_seen[event->type] += 1;
	event_last[event->type] = *event;
}

void events_forget(void)
{
	event_count = 0;
	memset(event_seen, 0, sizeof(event_seen));
	memset(event_last, 0, sizeof(event_last));
}

static void *suite_setup(void)
{
	zassert_equal(PSA_SUCCESS, psa_crypto_init());

	key_right = import_ikm(ikm_bytes, sizeof(ikm_bytes));

	uint8_t other[sizeof(ikm_bytes)];

	memcpy(other, ikm_bytes, sizeof(other));
	other[0] ^= 0xFF;
	key_wrong = import_ikm(other, sizeof(other));

	config.flash_area_id = TEST_PARTITION;
	config.ikm_key_id = key_right;
	config.event_cb = on_event;
	config.state_cb = trust_everything;

	config_wrong_key = config;
	config_wrong_key.ikm_key_id = key_wrong;

	return NULL;
}

static void before_each(void *fixture)
{
	ARG_UNUSED(fixture);

	events_forget();
	state_check_count = 0;
	memset(&last_state, 0, sizeof(last_state));

	ubi = k_malloc(ubi_device_size());
	zassert_not_null(ubi, "no memory for a device handle");
	memset(ubi, 0, ubi_device_size());

	flash_fail_writes_never();
	partition_fill(0xFF);
}

static void after_each(void *fixture)
{
	ARG_UNUSED(fixture);

	k_free(ubi);
	ubi = NULL;
}

ZTEST_SUITE(ubi_integration, NULL, suite_setup, before_each, after_each, NULL);

/* Module interface function definitions ----------------------------------- */

enum ubi_state_verdict trust_everything(const struct ubi_device_info *info,
					void *user_context)
{
	ARG_UNUSED(user_context);

	state_check_count += 1;
	last_state = *info;

	return UBI_STATE_TRUSTED;
}

enum ubi_state_verdict trust_nothing(const struct ubi_device_info *info,
				     void *user_context)
{
	ARG_UNUSED(user_context);

	state_check_count += 1;
	last_state = *info;

	return UBI_STATE_UNTRUSTED;
}

enum ubi_state_verdict trust_once(const struct ubi_device_info *info,
				  void *user_context)
{
	ARG_UNUSED(user_context);

	state_check_count += 1;
	last_state = *info;

	/* The attach asks first; everything after it is refused, which is how
	 * a test reaches the latch without unplugging the flash. */
	return (1 == state_check_count) ? UBI_STATE_TRUSTED :
					  UBI_STATE_UNTRUSTED;
}
```

## src/suite.h
```c
/**
 * \file    suite.h
 * \author  Kamil Kielbasa
 * \brief   The device handle and the callbacks the suite owns.
 *
 *          Everything declared here is set up before a test runs and torn
 *          down after it, so a test may read it but must not take
 *          responsibility for its lifetime.
 *
 * \copyright Copyright (c) 2026
 *
 */

/* Header guard ------------------------------------------------------------ */
#ifndef SUITE_H
#define SUITE_H

/* Include files ----------------------------------------------------------- */

/* Standard library headers: */
#include <stdbool.h>
#include <stdint.h>

/* UBI headers: */
#include <ubi/ubi.h>

/* Variable declarations --------------------------------------------------- */

/** Handle under test, allocated fresh before each test. */
extern struct ubi_device *ubi;

/** Configuration carrying the key the partition was formatted with. */
extern struct ubi_config config;

/** The same configuration, but with a key that will not verify. */
extern struct ubi_config config_wrong_key;

/** How many events the library reported during the current test. */
extern uint32_t event_count;

/** How many of each kind, indexed by \ref ubi_event_type. */
extern uint32_t event_seen[UBI_EVENT_PEB_BAD + 1];

/** The last event of each kind, so a test can check what it named. */
extern struct ubi_event event_last[UBI_EVENT_PEB_BAD + 1];

/** How many times the library asked the application for a verdict. */
extern uint32_t state_check_count;

/** What it showed the application the last time it asked. */
extern struct ubi_device_info last_state;

/* Function declarations --------------------------------------------------- */

/**
 * \brief Forget every event recorded so far.
 *
 *        Lets a test draw a line after a noisy setup and speak only about
 *        what the step under test reported.
 */
void events_forget(void);

/**
 * \brief Trust callback that accepts whatever it is shown.
 */
enum ubi_state_verdict trust_everything(const struct ubi_device_info *info,
					void *user_context);

/**
 * \brief Trust callback that refuses whatever it is shown.
 */
enum ubi_state_verdict trust_nothing(const struct ubi_device_info *info,
				     void *user_context);

/**
 * \brief Trust callback that accepts the attach and refuses everything after.
 */
enum ubi_state_verdict trust_once(const struct ubi_device_info *info,
				  void *user_context);

#endif /* SUITE_H */
```

## src/sweep.c
```c
/**
 * \file    sweep.c
 * \author  Kamil Kielbasa
 * \brief   Running one operation over and over from the same partition, with
 *          a fault moved a little further along each time. Flash simulator
 *          only.
 *
 * \copyright Copyright (c) 2026
 *
 */

/* Include files ----------------------------------------------------------- */

/* Standard library headers: */
#include <string.h>

/* Zephyr headers: */
#include <zephyr/ztest.h>

/* UBI headers: */
#include <ubi/ubi.h>

/* Test headers: */
#include "flash_faults.h"
#include "suite.h"
#include "sweep.h"

/* Module interface function definitions ----------------------------------- */

void sweep_attach(void)
{
	zassert_ok(ubi_device_init(ubi, &config));
}

void sweep_reboot(void)
{
	flash_faults_clear();
	zassert_ok(ubi_device_deinit(ubi));
}

bool leb_holds(uint32_t vol_id, uint32_t lnum, const uint8_t *expected,
	       size_t length)
{
	uint8_t read[UBI_TEST_PAYLOAD_SIZE] = { 0 };

	zassert_true(length <= sizeof(read));
	zassert_ok(ubi_leb_read(ubi, vol_id, lnum, 0, read, length));

	return 0 == memcmp(expected, read, length);
}

void leb_check(uint32_t vol_id, uint32_t lnum, const uint8_t *expected,
	       size_t length)
{
	zassert_true(leb_holds(vol_id, lnum, expected, length),
		     "volume %u block %u lost its contents", vol_id, lnum);
}

bool volume_present(const char *name)
{
	uint32_t vol_id = UBI_VOL_ID_INVALID;

	return 0 == ubi_volume_find(ubi, name, &vol_id);
}
```

## src/sweep.h
```c
/**
 * \file    sweep.h
 * \author  Kamil Kielbasa
 * \brief   Running one operation over and over from the same partition, with
 *          a fault moved a little further along each time. Flash simulator
 *          only.
 *
 * \copyright Copyright (c) 2026
 *
 */

/* Header guard ------------------------------------------------------------ */
#ifndef SWEEP_H
#define SWEEP_H

/* Include files ----------------------------------------------------------- */

/* Standard library headers: */
#include <stdbool.h>
#include <stddef.h>
#include <stdint.h>

/* Defines ----------------------------------------------------------------- */

/** Bytes a sweep moves its fault along by. Odd, so that it lands on every
 *  offset within a write block over the course of a sweep. */
#define SWEEP_STRIDE (3)

/* Function declarations --------------------------------------------------- */

/**
 * \brief Attach the device as it stands and fail the test if it will not.
 */
void sweep_attach(void);

/**
 * \brief Give the flash back its power and detach, as a reboot would.
 */
void sweep_reboot(void);

/**
 * \brief Report whether logical block \p lnum reads exactly \p expected.
 */
bool leb_holds(uint32_t vol_id, uint32_t lnum, const uint8_t *expected,
	       size_t length);

/**
 * \brief Fail unless logical block \p lnum reads exactly \p expected.
 */
void leb_check(uint32_t vol_id, uint32_t lnum, const uint8_t *expected,
	       size_t length);

/**
 * \brief Report whether a volume of that name is on the attached device.
 */
bool volume_present(const char *name);

#endif /* SWEEP_H */
```
