/*
 * Copyright (c) 2026 Kamil Kiełbasa
 * SPDX-License-Identifier: MIT
 *
 * native_sim with the geometry of the STM32H743 internal flash: 128 KiB
 * sectors, 32 bytes per write. UBI gets 4 MiB of a flash grown to 16 MiB,
 * which makes 32 blocks.
 */

&flashcontroller0 {
	reg = <0x00000000 0x01000000>;
};

&flash0 {
	reg = <0x00000000 0x01000000>;
	erase-block-size = <131072>;
	write-block-size = <32>;

	partitions {
		ubi_partition: partition@100000 {
			label = "ubi-storage";
			reg = <0x00100000 0x00400000>;
		};
	};
};
