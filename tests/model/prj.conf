## CMakeLists.txt
```
# Copyright (c) 2026 Kamil Kiełbasa
# SPDX-License-Identifier: MIT

cmake_minimum_required(VERSION 3.20.0)
find_package(Zephyr REQUIRED HINTS $ENV{ZEPHYR_BASE})

project(ubi_model)

include(${ZEPHYR_UBI_MODULE_DIR}/cmake/warnings.cmake)

target_sources(app PRIVATE
  ../common/forge.c
  ../common/partition.c
  ../common/suite.c
  ../common/table_copies.c
  src/model.c
  src/model_step.c
  src/test_model.c
)

# The flash simulator's faults and counters, and a device that refuses reads.
if(CONFIG_FLASH_SIMULATOR)
  target_sources(app PRIVATE
    ../common/flash_faults.c
    ../common/flash_shim.c
    ../common/flash_stats.c
  )
endif()

target_include_directories(app PRIVATE
  ${ZEPHYR_UBI_MODULE_DIR}/library
  ${CMAKE_CURRENT_SOURCE_DIR}/../common
)

ubi_target_warnings(app)
```

## Kconfig
```
# Copyright (c) 2026 Kamil Kiełbasa
# SPDX-License-Identifier: MIT

mainmenu "UBI model test"

config UBI_TEST_MODEL_STEPS
	int "Operations in one run"
	default 20000
	help
	  Operations picked at random and checked against the model. A
	  reattach is one of them.

config UBI_TEST_MODEL_SEED
	hex "Seed of the operations picked"
	default 0x5eed1e55
	help
	  The same seed on the same geometry picks the same operations, so a
	  failing run can be repeated.

config UBI_TEST_MODEL_FAULT_PERCENT
	int "Share of operations cut short, in percent"
	default 10
	range 0 100
	help
	  Operations cut short by a power loss or by a failed write, which only
	  the flash simulator can inject.

source "Kconfig.zephyr"
```

## prj.conf
```kconfig
CONFIG_ZTEST=y
CONFIG_UBI=y

CONFIG_FLASH=y
CONFIG_FLASH_MAP=y
CONFIG_FLASH_PAGE_LAYOUT=y

CONFIG_MBEDTLS=y
CONFIG_MBEDTLS_PSA_CRYPTO_C=y
CONFIG_ENTROPY_GENERATOR=y

# The device handle and its per-block bookkeeping come from here.
CONFIG_HEAP_MEM_POOL_SIZE=16384

CONFIG_UBI_MAX_NR_OF_VOLUMES=4

# Levelling has to have work within one run.
CONFIG_UBI_WEAR_LEVELING_THRESHOLD=64

# The library checks its own bookkeeping after every call.
CONFIG_UBI_SELF_CHECKS=y

CONFIG_MAIN_STACK_SIZE=16384
CONFIG_ZTEST_STACK_SIZE=16384

# Every fault injected would be logged.
CONFIG_LOG=y
CONFIG_UBI_LOG_LEVEL_OFF=y
```

## boards/native_sim.conf
```kconfig
CONFIG_FLASH_SIMULATOR=y

# NOR clears bits in a written byte; the simulator refuses unless this is on.
CONFIG_FLASH_SIMULATOR_DOUBLE_WRITES=y

CONFIG_FLASH_SIMULATOR_CALLBACKS=y

# The partition sits behind a shim that can refuse reads; see flash_shim.c.
CONFIG_FLASH_MAP_CUSTOM=y
```

## boards/native_sim.overlay
```dts
/*
 * Copyright (c) 2026 Kamil Kiełbasa
 * SPDX-License-Identifier: MIT
 *
 * 256 KiB, 64 blocks: few enough that the volumes fill the device and every
 * block takes its turn within one run.
 */

/delete-node/ &slot1_partition;
/delete-node/ &scratch_partition;

&flash0 {
	partitions {
		ubi_partition: partition@75000 {
			label = "ubi-storage";
			reg = <0x00075000 0x00040000>;
		};
	};
};
```

## boards/nrf5340dk_nrf5340_cpuapp.overlay
```dts
/*
 * Copyright (c) 2026 Kamil Kiełbasa
 * SPDX-License-Identifier: MIT
 *
 * 256 KiB of the MX25R64, 64 blocks, as the model has on the simulator.
 */

&mx25r64 {
	status = "okay";

	partitions {
		compatible = "fixed-partitions";
		#address-cells = <1>;
		#size-cells = <1>;

		ubi_partition: partition@0 {
			label = "ubi-storage";
			reg = <0x00000000 0x00040000>;
		};
	};
};
```

## src/model.c
```c
/**
 * \file    model.c
 * \author  Kamil Kielbasa
 * \brief   What the device has to hold, and checking that it does.
 *
 * \copyright Copyright (c) 2026
 *
 */

/* Include files ----------------------------------------------------------- */

/* Standard library headers: */
#include <errno.h>
#include <stdbool.h>
#include <stdint.h>
#include <stdio.h>

/* Zephyr headers: */
#include <zephyr/kernel.h>
#include <zephyr/sys/util.h>
#include <zephyr/ztest.h>

/* UBI headers: */
#include <ubi/ubi.h>

/* Test headers: */
#include "model.h"
#include "partition.h"
#include "suite.h"

/* Module defines ---------------------------------------------------------- */

/** Erased bytes checked past what a block holds. */
#define MODEL_TAIL (64)

/* Static function declarations -------------------------------------------- */

/**
 * \brief What byte \p at of a block has to read.
 */
static uint8_t leb_byte(const struct model_leb *leb, uint32_t at);

/**
 * \brief Report whether bytes \p from to \p to of a block read as \p leb
 *        says.
 */
static bool leb_reads_range(const struct model_volume *volume, uint32_t lnum,
			    const struct model_leb *leb, uint32_t from,
			    uint32_t to);

/**
 * \brief Settle a block after an attach: a copy an unmap let go of has come
 *        back or it has not.
 */
static void leb_settle(const struct model_volume *volume, uint32_t lnum,
		       struct model_leb *leb);

/**
 * \brief Settle the block an operation cut short was writing.
 */
static void leb_settle_target(const struct model_volume *volume, uint32_t lnum,
			      const struct model_leb *old,
			      const struct model_leb *new, bool partial,
			      struct model_leb *leb);

/* Module variables and constants ------------------------------------------ */

struct model model = { 0 };

struct model before = { 0 };

uint32_t step = 0;

uint32_t leb_size = 0;

uint32_t write_block = 0;

uint32_t lebs_shared = 0;

struct model_stats stats = { 0 };

const char *const op_name[OP_COUNT] = {
	[OP_CHANGE] = "change",	    [OP_APPEND] = "append",
	[OP_READ] = "read",	    [OP_MAP] = "map",
	[OP_UNMAP] = "unmap",	    [OP_ERASE] = "erase",
	[OP_CREATE] = "create",	    [OP_REMOVE] = "remove",
	[OP_RESIZE] = "resize",	    [OP_MAINTAIN] = "maintain",
	[OP_REATTACH] = "reattach",
};

/** State of the generator. */
static uint32_t random_state = CONFIG_UBI_TEST_MODEL_SEED;

/** Bytes read back. */
static uint8_t readback[MODEL_WRITE_MAX + MODEL_TAIL] = { 0 };

/* Static function definitions --------------------------------------------- */

static uint8_t leb_byte(const struct model_leb *leb, uint32_t at)
{
	uint32_t start = 0;

	if (!leb->mapped)
		return UBI_TEST_ERASED;

	for (uint32_t i = 0; i < leb->segments; ++i) {
		const struct model_segment *segment = &leb->segment[i];

		if (at < start + segment->length)
			return segment_byte(segment->seed, at - start);

		start += segment->length;
	}

	return UBI_TEST_ERASED;
}

static bool leb_reads_range(const struct model_volume *volume, uint32_t lnum,
			    const struct model_leb *leb, uint32_t from,
			    uint32_t to)
{
	for (uint32_t at = from; at < to; at += sizeof(readback)) {
		const uint32_t length = MIN(sizeof(readback), to - at);

		zassert_ok(ubi_leb_read(ubi, volume->vol_id, lnum, at, readback,
					length),
			   "step %u: volume %u block %u will not read", step,
			   volume->vol_id, lnum);

		for (uint32_t i = 0; i < length; ++i) {
			const uint8_t expected = leb_byte(leb, at + i);

			if (expected != readback[i])
				return false;
		}
	}

	return true;
}

static void leb_settle(const struct model_volume *volume, uint32_t lnum,
		       struct model_leb *leb)
{
	struct ubi_leb_info info = { 0 };

	if (!leb->ghost) {
		zassert_true(leb_reads(volume, lnum, leb),
			     "step %u: volume %u block %u does not hold what "
			     "the model has",
			     step, volume->vol_id, lnum);
		return;
	}

	zassert_ok(ubi_leb_get_info(ubi, volume->vol_id, lnum, &info));

	leb->ghost = false;

	if (!info.mapped) {
		*leb = (struct model_leb){ 0 };
		return;
	}

	leb->mapped = true;

	zassert_true(leb_reads(volume, lnum, leb),
		     "step %u: volume %u block %u came back with contents it "
		     "did not have when it was unmapped",
		     step, volume->vol_id, lnum);
}

static void leb_settle_target(const struct model_volume *volume, uint32_t lnum,
			      const struct model_leb *old,
			      const struct model_leb *new, bool partial,
			      struct model_leb *leb)
{
	struct ubi_leb_info info = { 0 };
	struct model_leb ghost = *old;

	zassert_ok(ubi_leb_get_info(ubi, volume->vol_id, lnum, &info));

	if (!info.mapped) {
		zassert_true(!old->mapped || !new->mapped,
			     "step %u: volume %u block %u lost its contents",
			     step, volume->vol_id, lnum);
		*leb = (struct model_leb){ 0 };
		return;
	}

	const bool holds_new = new->mapped &&leb_reads(volume, lnum, new);

	if (holds_new) {
		*leb = *new;
		return;
	}

	const bool holds_old = old->mapped && leb_reads(volume, lnum, old);

	if (holds_old) {
		*leb = *old;
		return;
	}

	ghost.mapped = true;
	ghost.ghost = false;

	const bool holds_ghost = old->ghost && leb_reads(volume, lnum, &ghost);

	if (holds_ghost) {
		*leb = ghost;
		return;
	}

	const bool holds_part =
		partial && new->mapped &&
		0 != new->segments &&leb_reads_cut(volume, lnum, new, leb);

	if (holds_part) {
		stats.partial += 1;
		return;
	}

	zassert_unreachable("step %u: volume %u block %u holds neither what "
			    "it held nor what was written to it",
			    step, volume->vol_id, lnum);
}

/* Module interface function definitions ----------------------------------- */

uint32_t random_next(void)
{
	uint32_t x = random_state;

	x ^= x << 13;
	x ^= x >> 17;
	x ^= x << 5;
	random_state = x;

	return x;
}

uint32_t random_below(uint32_t bound)
{
	return random_next() % bound;
}

uint8_t segment_byte(uint32_t seed, uint32_t at)
{
	uint32_t x = seed + at * 0x9E3779B1UL;

	x ^= x >> 15;
	x *= 0x2C1B3C6DUL;
	x ^= x >> 12;

	return (uint8_t)x;
}

uint32_t leb_written(const struct model_leb *leb)
{
	uint32_t written = 0;

	for (uint32_t i = 0; i < leb->segments; ++i)
		written += leb->segment[i].length;

	return written;
}

void volume_name(uint32_t slot, char name[MODEL_NAME_SIZE])
{
	const int length = snprintf(name, MODEL_NAME_SIZE, "v%u", slot);

	zassert_between_inclusive(length, 2, MODEL_NAME_SIZE - 1);
}

bool leb_reads(const struct model_volume *volume, uint32_t lnum,
	       const struct model_leb *leb)
{
	struct ubi_leb_info info = { 0 };

	zassert_ok(ubi_leb_get_info(ubi, volume->vol_id, lnum, &info),
		   "step %u: volume %u block %u is not there", step,
		   volume->vol_id, lnum);

	if (info.mapped != leb->mapped)
		return false;

	return leb_reads_range(volume, lnum, leb, 0,
			       MIN(leb_size, leb_written(leb) + MODEL_TAIL));
}

bool leb_reads_cut(const struct model_volume *volume, uint32_t lnum,
		   const struct model_leb *leb, struct model_leb *found)
{
	const struct model_segment *last = &leb->segment[leb->segments - 1];
	const uint32_t start = leb_written(leb) - last->length;
	const uint32_t reach = MIN(last->length + MODEL_TAIL, leb_size - start);
	const bool head_holds = leb_reads_range(volume, lnum, leb, 0, start);
	uint32_t kept = 0;

	if (!head_holds)
		return false;

	zassert_ok(ubi_leb_read(ubi, volume->vol_id, lnum, start, readback,
				reach),
		   "step %u: volume %u block %u will not read", step,
		   volume->vol_id, lnum);

	/* A write cut short stops at a byte; everything after it is still
	 * erased. */
	for (uint32_t i = 0; i < reach; ++i) {
		if (UBI_TEST_ERASED != readback[i])
			kept = i + 1;
	}

	if (kept > last->length)
		return false;

	for (uint32_t i = 0; i < kept; ++i) {
		const uint8_t expected = segment_byte(last->seed, i);

		if (expected != readback[i])
			return false;
	}

	*found = *leb;
	found->segment[leb->segments - 1].length = kept;
	found->closed = true;

	if (0 == kept)
		found->segments -= 1;

	return true;
}

bool volumes_are(struct model *expected)
{
	struct ubi_device_info info = { 0 };
	uint32_t count = 0;
	uint32_t claimed = 0;

	for (uint32_t slot = 0; slot < MODEL_VOLUMES; ++slot) {
		struct model_volume *volume = &expected->volume[slot];
		struct ubi_volume_info found = { 0 };
		char name[MODEL_NAME_SIZE] = { 0 };
		uint32_t vol_id = UBI_VOL_ID_INVALID;

		volume_name(slot, name);

		const int ret = ubi_volume_find(ubi, name, &vol_id);

		if (!volume->exists) {
			if (-ENOENT != ret)
				return false;

			continue;
		}

		if (0 != ret)
			return false;

		zassert_ok(ubi_volume_get_info(ubi, vol_id, &found));

		if (found.leb_count != volume->leb_count)
			return false;

		if (UBI_VOL_ID_INVALID != volume->vol_id &&
		    vol_id != volume->vol_id)
			return false;

		volume->vol_id = vol_id;
		count += 1;
		claimed += volume->leb_count;
	}

	zassert_ok(ubi_device_get_info(ubi, &info));
	zassert_equal(count, info.volume_count, "step %u", step);
	zassert_equal(lebs_shared - claimed, info.free_lebs,
		      "step %u: the device shares out logical blocks the "
		      "volumes do not have",
		      step);

	return true;
}

void model_verify(void)
{
	zassert_true(volumes_are(&model),
		     "step %u: the volumes are not the ones the model has",
		     step);

	for (uint32_t slot = 0; slot < MODEL_VOLUMES; ++slot) {
		const struct model_volume *volume = &model.volume[slot];

		if (!volume->exists)
			continue;

		for (uint32_t lnum = 0; lnum < volume->leb_count; ++lnum)
			zassert_true(leb_reads(volume, lnum,
					       &volume->leb[lnum]),
				     "step %u: volume %u block %u does not "
				     "hold what the model has",
				     step, volume->vol_id, lnum);
	}
}

void attach_timed(void)
{
	const int64_t start = k_uptime_get();

	zassert_ok(ubi_device_init(ubi, &config),
		   "step %u: the device would not attach", step);

	stats.attach_last = (uint32_t)(k_uptime_get() - start);
	stats.attach_max = MAX(stats.attach_max, stats.attach_last);
}

void model_settle(struct model *settled, const struct model_step *s,
		  const struct model *old)
{
	const bool one_block = OP_CHANGE == s->op || OP_APPEND == s->op ||
			       OP_MAP == s->op || OP_ERASE == s->op;

	for (uint32_t slot = 0; slot < MODEL_VOLUMES; ++slot) {
		struct model_volume *volume = &settled->volume[slot];

		if (!volume->exists)
			continue;

		for (uint32_t lnum = 0; lnum < volume->leb_count; ++lnum) {
			struct model_leb *leb = &volume->leb[lnum];

			if (one_block && slot == s->slot && lnum == s->lnum)
				leb_settle_target(
					volume, lnum,
					&old->volume[slot].leb[lnum],
					&s->after.volume[slot].leb[lnum],
					s->partial, leb);
			else
				leb_settle(volume, lnum, leb);
		}
	}
}

void leb_settle_failed(const struct model_step *s)
{
	const struct model_volume *volume = &model.volume[s->slot];
	const struct model_leb *old = &before.volume[s->slot].leb[s->lnum];
	struct model_leb *leb = &model.volume[s->slot].leb[s->lnum];
	struct ubi_leb_info info = { 0 };

	zassert_ok(ubi_leb_get_info(ubi, volume->vol_id, s->lnum, &info));

	if (!info.mapped) {
		zassert_true(!old->mapped || OP_ERASE == s->op,
			     "step %u: a failed %s unmapped volume %u block %u",
			     step, op_name[s->op], volume->vol_id, s->lnum);

		/* Unmapped before the erase failed, and may come back. */
		if (old->mapped) {
			leb->mapped = false;
			leb->ghost = true;
		}

		return;
	}

	const bool holds_old = leb_reads(volume, s->lnum, old);

	if (holds_old)
		return;

	zassert_true(
		OP_APPEND == s->op &&
			leb_reads_cut(volume, s->lnum,
				      &s->after.volume[s->slot].leb[s->lnum],
				      leb),
		"step %u: a failed %s left volume %u block %u neither as "
		"it was nor part way",
		step, op_name[s->op], volume->vol_id, s->lnum);

	stats.partial += 1;
}

void reattach(void)
{
	zassert_ok(ubi_device_deinit(ubi));
	attach_timed();

	zassert_true(volumes_are(&model),
		     "step %u: the volumes changed across a reattach", step);

	for (uint32_t slot = 0; slot < MODEL_VOLUMES; ++slot) {
		struct model_volume *volume = &model.volume[slot];

		if (!volume->exists)
			continue;

		for (uint32_t lnum = 0; lnum < volume->leb_count; ++lnum)
			leb_settle(volume, lnum, &volume->leb[lnum]);
	}
}
```

## src/model.h
```c
/**
 * \file    model.h
 * \author  Kamil Kielbasa
 * \brief   What the device has to hold, and checking that it does.
 *
 * \copyright Copyright (c) 2026
 *
 */

/* Header guard ------------------------------------------------------------ */
#ifndef MODEL_H
#define MODEL_H

/* Include files ----------------------------------------------------------- */

/* Standard library headers: */
#include <stdbool.h>
#include <stdint.h>

/* UBI headers: */
#include <ubi/ubi.h>

/* Defines ----------------------------------------------------------------- */

/** Volumes the model keeps, as many as the build allows. */
#define MODEL_VOLUMES (CONFIG_UBI_MAX_NR_OF_VOLUMES)

/** Logical blocks of the largest volume, enough for the volumes to fill the
 *  device between them. */
#define MODEL_LEBS (16)

/** Writes a logical block takes before it has to be changed or erased. */
#define MODEL_SEGMENTS (3)

/** Longest write, in bytes. */
#define MODEL_WRITE_MAX (512)

/** Room for a volume name: "v" and a slot of up to ten digits. */
#define MODEL_NAME_SIZE (12)

/* Types and type definitions ---------------------------------------------- */

/** Bytes written in one go, generated from a seed. */
struct model_segment {
	/** What the bytes are generated from. */
	uint32_t seed;
	/** How many. */
	uint32_t length;
};

/** What a logical block has to hold. */
struct model_leb {
	/** A physical block backs it. */
	bool mapped;
	/** Unmapped, but the copy the unmap let go of may come back at the
	 *  next attach, holding the segments below. */
	bool ghost;
	/** A write into it stopped part way, so nothing may be appended until
	 *  it is changed or erased. */
	bool closed;
	/** Segments written back to back from the start of the block. */
	uint32_t segments;
	/** The segments. */
	struct model_segment segment[MODEL_SEGMENTS];
};

/** What a volume has to be. */
struct model_volume {
	/** The volume exists. */
	bool exists;
	/** Its identifier, or #UBI_VOL_ID_INVALID until the device says. */
	uint32_t vol_id;
	/** Logical blocks it has. */
	uint32_t leb_count;
	/** What each has to hold. */
	struct model_leb leb[MODEL_LEBS];
};

/** Everything the device has to hold. */
struct model {
	/** Volumes, by the slot their name is made from. */
	struct model_volume volume[MODEL_VOLUMES];
};

/** Operations the generator picks from. */
enum model_op {
	OP_CHANGE,
	OP_APPEND,
	OP_READ,
	OP_MAP,
	OP_UNMAP,
	OP_ERASE,
	OP_CREATE,
	OP_REMOVE,
	OP_RESIZE,
	OP_MAINTAIN,
	OP_REATTACH,
	OP_COUNT,
};

/** One operation, and what it leaves if it goes through. */
struct model_step {
	/** What to do. */
	enum model_op op;
	/** Volume slot concerned. */
	uint32_t slot;
	/** Logical block concerned, for operations on one. */
	uint32_t lnum;
	/** Bytes to write. */
	uint32_t length;
	/** What they are generated from. */
	uint32_t seed;
	/** Where they go. */
	uint32_t offset;
	/** New size, for a resize. */
	uint32_t leb_count;
	/** Housekeeping, for a maintenance step. */
	enum ubi_maintenance_op maintenance;
	/** Its budget. */
	uint32_t budget;
	/** What the device answers if the operation goes through. */
	int expected;
	/** The block written may be left with its last segment cut short. */
	bool partial;
	/** The model once the operation has gone through. */
	struct model after;
};

/** What a run did, for the report at the end. */
struct model_stats {
	/** Operations carried out, by kind. */
	uint32_t done[OP_COUNT];
	/** Refused as the model expected. */
	uint32_t refused;
	/** Refused for want of space the model could not see. */
	uint32_t no_space;
	/** Cut short by a power loss. */
	uint32_t cuts;
	/** Hit by a failed write. */
	uint32_t failures;
	/** Left with a write stopped part way. */
	uint32_t partial;
	/** Blocks relocation moved. */
	uint32_t relocated;
	/** Milliseconds the last attach took. */
	uint32_t attach_last;
	/** And the longest. */
	uint32_t attach_max;
};

/* Variable declarations --------------------------------------------------- */

/** What the device has to hold. */
extern struct model model;

/** The model before the operation under way. */
extern struct model before;

/** Operation under way, for the messages. */
extern uint32_t step;

/** Bytes a logical block holds. */
extern uint32_t leb_size;

/** Write granularity of the flash. */
extern uint32_t write_block;

/** Logical blocks the volumes may share out, all of them unclaimed. */
extern uint32_t lebs_shared;

/** What the run did. */
extern struct model_stats stats;

/** Names of the operations, for the messages. */
extern const char *const op_name[OP_COUNT];

/* Function declarations --------------------------------------------------- */

/**
 * \brief Next number of the generator.
 */
uint32_t random_next(void);

/**
 * \brief A number below \p bound.
 */
uint32_t random_below(uint32_t bound);

/**
 * \brief Byte \p at of a segment generated from \p seed.
 */
uint8_t segment_byte(uint32_t seed, uint32_t at);

/**
 * \brief Bytes a block holds, from its start.
 */
uint32_t leb_written(const struct model_leb *leb);

/**
 * \brief Name of the volume in \p slot.
 */
void volume_name(uint32_t slot, char name[MODEL_NAME_SIZE]);

/**
 * \brief Report whether a block is mapped as \p leb says and reads as it
 *        says.
 */
bool leb_reads(const struct model_volume *volume, uint32_t lnum,
	       const struct model_leb *leb);

/**
 * \brief Report whether a block reads as \p leb with its last segment cut
 *        short, and say how in \p found.
 */
bool leb_reads_cut(const struct model_volume *volume, uint32_t lnum,
		   const struct model_leb *leb, struct model_leb *found);

/**
 * \brief Report whether the volumes on the device are the ones \p expected
 *        holds, and take their identifiers into it.
 */
bool volumes_are(struct model *expected);

/**
 * \brief Fail unless the device holds exactly what the model says.
 */
void model_verify(void);

/**
 * \brief Attach, and time it.
 */
void attach_timed(void);

/**
 * \brief Settle every block after an attach.
 */
void model_settle(struct model *settled, const struct model_step *s,
		  const struct model *old);

/**
 * \brief Settle the block a failed write hit, while the device carries on.
 */
void leb_settle_failed(const struct model_step *s);

/**
 * \brief Detach, attach again and settle what an unmap left.
 */
void reattach(void);

#endif /* MODEL_H */
```

## src/model_step.c
```c
/**
 * \file    model_step.c
 * \author  Kamil Kielbasa
 * \brief   Picking one operation, carrying it out, and holding the device to
 *          the model afterwards.
 *
 * \copyright Copyright (c) 2026
 *
 */

/* Include files ----------------------------------------------------------- */

/* Standard library headers: */
#include <errno.h>
#include <stdbool.h>
#include <stdint.h>

/* Zephyr headers: */
#include <zephyr/sys/util.h>
#include <zephyr/ztest.h>

/* UBI headers: */
#include <ubi/ubi.h>

/* Test headers: */
#include "flash_faults.h"
#include "model.h"
#include "model_step.h"
#include "suite.h"

/* Module defines ---------------------------------------------------------- */

#if defined(CONFIG_FLASH_SIMULATOR)

/** Bytes an operation writes that a power cut is placed among. */
#define CUT_REACH (1536)

/** Erases an operation starts that a torn erase is placed among. */
#define ERASE_CUT_REACH (4)

#endif /* CONFIG_FLASH_SIMULATOR */

/* Module type definitions ------------------------------------------------- */

/** How an operation is cut short. */
enum model_fault {
	FAULT_NONE,
	FAULT_POWER_CUT,
	FAULT_ERASE_CUT,
	FAULT_WRITE_FAILS,
};

/* Static function declarations -------------------------------------------- */

/**
 * \brief Report whether blocks out of service explain a lack of space.
 */
static bool space_explained(void);

/**
 * \brief Pick a volume and a logical block of it.
 */
static bool leb_pick(uint32_t *slot, uint32_t *lnum);

/**
 * \brief Pick an operation, from those that write when \p writing.
 */
static enum model_op op_pick(bool writing);

/**
 * \brief Choose the arguments of \p op and work out what it leaves.
 *
 * \return Whether the operation can be carried out at all.
 */
static bool step_plan(enum model_op op, struct model_step *s);

/**
 * \brief Carry an operation out.
 */
static int step_perform(const struct model_step *s);

/**
 * \brief Carry an operation out, cut short as \p fault says, and check what
 *        the device holds afterwards.
 */
static void step_execute(struct model_step *s, enum model_fault fault);

/* Module variables and constants ------------------------------------------ */

/** The operation under way. */
static struct model_step current = { 0 };

/** Bytes a write takes from. */
static uint8_t buffer[MODEL_WRITE_MAX] = { 0 };

/** How often each operation is picked. */
static const uint8_t op_weight[OP_COUNT] = {
	[OP_CHANGE] = 20,   [OP_APPEND] = 12,  [OP_READ] = 8,
	[OP_MAP] = 4,	    [OP_UNMAP] = 6,    [OP_ERASE] = 5,
	[OP_CREATE] = 4,    [OP_REMOVE] = 2,   [OP_RESIZE] = 3,
	[OP_MAINTAIN] = 14, [OP_REATTACH] = 2,
};

/* Static function definitions --------------------------------------------- */

static bool space_explained(void)
{
	struct ubi_device_info info = { 0 };

	zassert_ok(ubi_device_get_info(ubi, &info));

	return 0 != info.bad_pebs + info.corrupt_pebs;
}

static bool leb_pick(uint32_t *slot, uint32_t *lnum)
{
	const uint32_t first = random_below(MODEL_VOLUMES);

	for (uint32_t i = 0; i < MODEL_VOLUMES; ++i) {
		const uint32_t candidate = (first + i) % MODEL_VOLUMES;
		const struct model_volume *volume = &model.volume[candidate];

		if (!volume->exists)
			continue;

		*slot = candidate;
		*lnum = random_below(volume->leb_count);

		return true;
	}

	return false;
}

static enum model_op op_pick(bool writing)
{
	uint32_t total = 0;

	for (uint32_t op = 0; op < OP_COUNT; ++op)
		total += op_weight[op];

	for (;;) {
		uint32_t pick = random_below(total);
		uint32_t op = 0;

		while (pick >= op_weight[op]) {
			pick -= op_weight[op];
			op += 1;
		}

		/* None of these writes anything a fault could cut short. */
		if (writing &&
		    (OP_READ == op || OP_UNMAP == op || OP_REATTACH == op))
			continue;

		return (enum model_op)op;
	}
}

static bool step_plan(enum model_op op, struct model_step *s)
{
	*s = (struct model_step){ .op = op, .after = model };

	if (OP_CREATE == op) {
		struct ubi_device_info info = { 0 };

		zassert_ok(ubi_device_get_info(ubi, &info));

		for (s->slot = 0; s->slot < MODEL_VOLUMES; ++s->slot) {
			if (!model.volume[s->slot].exists)
				break;
		}

		if (MODEL_VOLUMES == s->slot || 0 == info.free_lebs)
			return false;

		s->leb_count =
			1 + random_below(MIN(MODEL_LEBS, info.free_lebs));
		s->after.volume[s->slot] = (struct model_volume){
			.exists = true,
			.vol_id = UBI_VOL_ID_INVALID,
			.leb_count = s->leb_count,
		};

		return true;
	}

	if (OP_MAINTAIN == op) {
		const uint32_t maintenance =
			random_below(UBI_MAINTENANCE_DISCARD + 1);

		s->maintenance = (enum ubi_maintenance_op)maintenance;
		s->budget = 1 + random_below(4);

		return true;
	}

	if (OP_REATTACH == op)
		return true;

	const bool picked = leb_pick(&s->slot, &s->lnum);

	if (!picked)
		return false;

	struct model_volume *volume = &s->after.volume[s->slot];
	struct model_leb *leb = &volume->leb[s->lnum];
	const uint32_t writes = MODEL_WRITE_MAX / write_block;

	s->length = write_block * (1 + random_below(writes));
	s->seed = random_next();

	switch (op) {
	case OP_CHANGE:
		/* With nothing older behind it, a copy cut short is kept. */
		s->partial = !leb->mapped;
		*leb = (struct model_leb){
			.mapped = true,
			.segments = 1,
			.segment = { { .seed = s->seed, .length = s->length } },
		};
		break;
	case OP_APPEND:
		if (leb->mapped &&
		    (leb->closed || MODEL_SEGMENTS == leb->segments))
			return false;

		if (!leb->mapped)
			*leb = (struct model_leb){ .mapped = true };

		s->offset = leb_written(leb);
		s->partial = true;
		leb->segment[leb->segments].seed = s->seed;
		leb->segment[leb->segments].length = s->length;
		leb->segments += 1;
		break;
	case OP_MAP:
		if (leb->mapped) {
			s->expected = -EEXIST;
			break;
		}

		*leb = (struct model_leb){ .mapped = true };
		break;
	case OP_UNMAP:
		if (leb->mapped) {
			leb->mapped = false;
			leb->ghost = true;
		}
		break;
	case OP_ERASE:
		*leb = (struct model_leb){ 0 };
		break;
	case OP_REMOVE:
		*volume = (struct model_volume){ 0 };
		break;
	case OP_RESIZE: {
		struct ubi_device_info info = { 0 };

		zassert_ok(ubi_device_get_info(ubi, &info));

		s->leb_count = 1 + random_below(MODEL_LEBS);

		if (s->leb_count > volume->leb_count + info.free_lebs)
			s->leb_count = volume->leb_count + info.free_lebs;

		for (uint32_t lnum = s->leb_count; lnum < volume->leb_count;
		     ++lnum) {
			if (volume->leb[lnum].mapped)
				s->expected = -EBUSY;
		}

		if (0 != s->expected)
			break;

		/* Shrunk away or grown back, a block starts empty. */
		for (uint32_t lnum = MIN(s->leb_count, volume->leb_count);
		     lnum < MODEL_LEBS; ++lnum)
			volume->leb[lnum] = (struct model_leb){ 0 };

		volume->leb_count = s->leb_count;
		break;
	}
	case OP_READ:
	case OP_CREATE:
	case OP_MAINTAIN:
	case OP_REATTACH:
	case OP_COUNT:
	default:
		break;
	}

	if (0 != s->expected)
		s->after = model;

	return true;
}

static int step_perform(const struct model_step *s)
{
	const struct model_volume *volume = &model.volume[s->slot];
	struct ubi_maintenance_result result = { 0 };
	char name[MODEL_NAME_SIZE] = { 0 };
	int ret = 0;

	for (uint32_t i = 0; i < s->length; ++i)
		buffer[i] = segment_byte(s->seed, i);

	switch (s->op) {
	case OP_CHANGE:
		return ubi_leb_change(ubi, volume->vol_id, s->lnum, buffer,
				      s->length);
	case OP_APPEND:
		return ubi_leb_write_at(ubi, volume->vol_id, s->lnum, s->offset,
					buffer, s->length);
	case OP_MAP:
		return ubi_leb_map(ubi, volume->vol_id, s->lnum);
	case OP_UNMAP:
		return ubi_leb_unmap(ubi, volume->vol_id, s->lnum);
	case OP_ERASE:
		return ubi_leb_erase(ubi, volume->vol_id, s->lnum);
	case OP_CREATE: {
		const struct ubi_volume_config wanted = {
			.name = name,
			.leb_count = s->leb_count,
		};
		uint32_t vol_id = UBI_VOL_ID_INVALID;

		volume_name(s->slot, name);

		return ubi_volume_create(ubi, &wanted, &vol_id);
	}
	case OP_REMOVE:
		return ubi_volume_remove(ubi, volume->vol_id);
	case OP_RESIZE:
		return ubi_volume_resize(ubi, volume->vol_id, s->leb_count);
	case OP_MAINTAIN:
		ret = ubi_maintenance(ubi, s->maintenance, s->budget, &result);

		if (UBI_MAINTENANCE_RELOCATE == s->maintenance)
			stats.relocated += result.performed;

		return ret;
	case OP_READ:
	case OP_REATTACH:
	case OP_COUNT:
	default:
		return 0;
	}
}

static void step_execute(struct model_step *s, enum model_fault fault)
{
	const bool one_block = OP_CHANGE == s->op || OP_APPEND == s->op ||
			       OP_MAP == s->op || OP_ERASE == s->op;
	bool cut = false;
	bool fired = false;

	before = model;

#if defined(CONFIG_FLASH_SIMULATOR)
	switch (fault) {
	case FAULT_POWER_CUT:
		flash_power_cut_after(random_below(CUT_REACH));
		break;
	case FAULT_ERASE_CUT:
		flash_power_cut_during_erase(random_below(ERASE_CUT_REACH));
		break;
	case FAULT_WRITE_FAILS:
		flash_fail_one_write_after(random_below(CUT_REACH));
		break;
	case FAULT_NONE:
	default:
		break;
	}
#endif

	const int ret = step_perform(s);

#if defined(CONFIG_FLASH_SIMULATOR)
	cut = flash_power_is_cut();
	fired = flash_fault_fired();
	flash_faults_clear();
#else
	ARG_UNUSED(fault);
#endif

	if (cut) {
		stats.cuts += 1;
		zassert_ok(ubi_device_deinit(ubi));
		attach_timed();

		const bool took = volumes_are(&s->after);

		if (took) {
			model = s->after;
		} else {
			model = before;
			zassert_true(
				volumes_are(&model),
				"step %u: a cut %s left volumes neither as "
				"before nor as after it",
				step, op_name[s->op]);
		}

		model_settle(&model, s, &before);
		return;
	}

	if (fired) {
		stats.failures += 1;

		/* What the device serves now is what the next attach finds. */
		if (0 == ret) {
			model = s->after;
		} else {
			model = before;

			if (one_block)
				leb_settle_failed(s);
		}

		model_verify();
		return;
	}

	const bool no_space = -ENOSPC == ret && -ENOSPC != s->expected &&
			      space_explained();

	if (no_space) {
		stats.no_space += 1;
		model_verify();
		return;
	}

	zassert_equal(s->expected, ret, "step %u: %s returned %d, not %d", step,
		      op_name[s->op], ret, s->expected);

	if (0 != s->expected)
		stats.refused += 1;

	model = s->after;

	if (one_block || OP_UNMAP == s->op || OP_READ == s->op)
		zassert_true(leb_reads(&model.volume[s->slot], s->lnum,
				       &model.volume[s->slot].leb[s->lnum]),
			     "step %u: after %s volume %u block %u does not "
			     "hold what the model has",
			     step, op_name[s->op], model.volume[s->slot].vol_id,
			     s->lnum);
	else
		model_verify();
}

/* Module interface function definitions ----------------------------------- */

void step_run(void)
{
	enum model_fault fault = FAULT_NONE;

#if defined(CONFIG_FLASH_SIMULATOR)
	const bool faulty = random_below(100) <
			    CONFIG_UBI_TEST_MODEL_FAULT_PERCENT;

	if (faulty)
		fault = (enum model_fault)(1 + random_below(3));
#endif

	for (;;) {
		const enum model_op op = op_pick(FAULT_NONE != fault);
		const bool planned = step_plan(op, &current);

		if (!planned)
			continue;

		stats.done[op] += 1;

		if (OP_REATTACH == op)
			reattach();
		else
			step_execute(&current, fault);

		return;
	}
}
```

## src/model_step.h
```c
/**
 * \file    model_step.h
 * \author  Kamil Kielbasa
 * \brief   Picking one operation, carrying it out, and holding the device to
 *          the model afterwards.
 *
 * \copyright Copyright (c) 2026
 *
 */

/* Header guard ------------------------------------------------------------ */
#ifndef MODEL_STEP_H
#define MODEL_STEP_H

/* Function declarations --------------------------------------------------- */

/**
 * \brief Pick one operation and carry it out, cut short now and then on the
 *        flash simulator.
 */
void step_run(void);

#endif /* MODEL_STEP_H */
```

## src/test_model.c
```c
/**
 * \file    test_model.c
 * \author  Kamil Kielbasa
 * \brief   Every operation, in a random order, against a model of what the
 *          device has to hold.
 *
 *          A seeded generator picks each operation and its arguments, and
 *          the model says what the device has to answer and hold after it.
 *          On the flash simulator some operations are cut short by a power
 *          loss or by a failed write; the device then has to hold what it
 *          held before or what the operation would have left, and a write
 *          that is not atomic may stop anywhere.
 *
 * \copyright Copyright (c) 2026
 *
 */

/* Include files ----------------------------------------------------------- */

/* Standard library headers: */
#include <stdint.h>

/* Zephyr headers: */
#include <zephyr/sys/printk.h>
#include <zephyr/ztest.h>

/* UBI headers: */
#include <ubi/ubi.h>

/* Test headers: */
#include "model.h"
#include "model_step.h"
#include "suite.h"

/* Module variables and constants ------------------------------------------ */

UBI_TEST_SUITE(ubi_model);

/* Module interface function definitions ----------------------------------- */

/*
 * Given: a formatted device and a model of what it holds.
 * When:  operations of every kind are carried out in a random order, some
 *        of them cut short by a power loss or by a failed write.
 * Then:  the device always answers and holds what the model says, and it
 *        never writes twice over the same bytes.
 */
ZTEST(ubi_model, test_the_device_holds_what_the_model_says)
{
	struct ubi_device_info info = { 0 };

	zassert_ok(ubi_device_format(&config));
	attach_timed();
	zassert_ok(ubi_device_get_info(ubi, &info));

	leb_size = info.leb_size;
	write_block = info.write_block_size;
	lebs_shared = info.free_lebs;

	zassert_true(MODEL_SEGMENTS * MODEL_WRITE_MAX <= leb_size);
	zassert_equal(0, MODEL_WRITE_MAX % write_block);

	printk("model: seed 0x%08x, %u steps, %u blocks of %u bytes written "
	       "%u at a time\n",
	       (uint32_t)CONFIG_UBI_TEST_MODEL_SEED,
	       (uint32_t)CONFIG_UBI_TEST_MODEL_STEPS, info.peb_count,
	       info.peb_size, write_block);

	for (step = 0; step < CONFIG_UBI_TEST_MODEL_STEPS; ++step)
		step_run();

	reattach();
	model_verify();

	zassert_equal(0, event_count[UBI_EVENT_HDR_TAMPERED],
		      "nothing was tampered with");
	zassert_equal(0, event_count[UBI_EVENT_LEB_ORPHANED],
		      "no block claims a volume the device never created");

	for (uint32_t op = 0; op < OP_COUNT; ++op)
		printk("model: %u %s\n", stats.done[op], op_name[op]);

	printk("model: %u refused as expected, %u for want of space, %u cut "
	       "short, %u failed writes, %u left part way, %u relocated\n",
	       stats.refused, stats.no_space, stats.cuts, stats.failures,
	       stats.partial, stats.relocated);
	printk("model: attach of %u blocks took %u ms, %u ms at most\n",
	       info.peb_count, stats.attach_last, stats.attach_max);

	zassert_ok(ubi_device_deinit(ubi));
}
```
