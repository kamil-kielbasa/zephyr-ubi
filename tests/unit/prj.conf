## CMakeLists.txt
```
# Copyright (c) 2026, Kamil Kiełbasa and others
# SPDX-License-Identifier: MIT

cmake_minimum_required(VERSION 3.20.0)
find_package(Zephyr REQUIRED HINTS $ENV{ZEPHYR_BASE})

project(ubi_unit)

include(${ZEPHYR_UBI_MODULE_DIR}/cmake/warnings.cmake)

target_sources(app PRIVATE
  src/headers.c
  src/keys.c
  src/suite.c
  src/test_header.c
  src/test_kat.c
  src/test_key.c
  src/test_mac.c
  src/test_volume_table.c
)

# Header serialization and key derivation have no public API of their own.
target_include_directories(app PRIVATE ${ZEPHYR_UBI_MODULE_DIR}/library)

ubi_target_warnings(app)
```

## prj.conf
```kconfig
CONFIG_ZTEST=y
CONFIG_UBI=y

CONFIG_MBEDTLS=y
CONFIG_MBEDTLS_PSA_CRYPTO_C=y
CONFIG_ENTROPY_GENERATOR=y

CONFIG_MAIN_STACK_SIZE=8192
CONFIG_ZTEST_STACK_SIZE=8192
```

## src/main.c
```c
/**
 * \file    main.c
 * \author  Kamil Kielbasa
 * \brief   Unit tests for header serialization and key derivation.
 *
 *          Neither module has a public API of its own, so the tests reach
 *          them through the library's internal headers. Nothing is added to
 *          the library to make it testable.
 *
 * \copyright Copyright (c) 2026
 *
 */

/* Include files ----------------------------------------------------------- */

/* Standard library headers: */
#include <errno.h>
#include <string.h>

/* Zephyr headers: */
#include <zephyr/sys/byteorder.h>
#include <zephyr/sys/crc.h>
#include <zephyr/ztest.h>

/* PSA headers: */
#include <psa/crypto.h>

/* UBI headers: */
#include "ubi_header.h"
#include "ubi_key.h"

/* Module defines ---------------------------------------------------------- */

/** Offset of the CRC within either header. */
#define HEADER_CRC_OFFSET (0x3C)

/** A byte inside the erase counter field, safe to flip in tests. */
#define EC_ERASE_COUNT_OFFSET (0x08)

/** Arbitrary but fixed block number for tests that do not vary it. */
#define TEST_PNUM (7)

/** Arbitrary but fixed image sequence number. */
#define TEST_IMAGE_SEQ (0xA5A5F00DUL)

/** Byte an erase leaves behind on the flash these tests pretend to use. */
#define TEST_ERASE_VALUE (0xFF)

/* Module variables and constants ------------------------------------------ */

static const uint8_t test_ikm[32] = {
	0x00, 0x01, 0x02, 0x03, 0x04, 0x05, 0x06, 0x07, 0x08, 0x09, 0x0A,
	0x0B, 0x0C, 0x0D, 0x0E, 0x0F, 0x10, 0x11, 0x12, 0x13, 0x14, 0x15,
	0x16, 0x17, 0x18, 0x19, 0x1A, 0x1B, 0x1C, 0x1D, 0x1E, 0x1F,
};

/** A block straight out of an erase. */
static const uint8_t erased_block[UBI_HEADER_SIZE] = {
	[0 ...(UBI_HEADER_SIZE - 1)] = 0xFF,
};

static psa_key_id_t ikm_key;
static psa_key_id_t key_header;
static psa_key_id_t key_volume_table;

/* Static function definitions --------------------------------------------- */

/**
 * \brief Import the test keying material as a PSA derivation key.
 */
static psa_key_id_t import_ikm(const uint8_t *ikm, size_t length,
			       psa_key_usage_t usage)
{
	psa_key_attributes_t attributes = PSA_KEY_ATTRIBUTES_INIT;
	psa_key_id_t key_id = PSA_KEY_ID_NULL;

	psa_set_key_type(&attributes, PSA_KEY_TYPE_DERIVE);
	psa_set_key_usage_flags(&attributes, usage);
	psa_set_key_algorithm(&attributes, PSA_ALG_HKDF(PSA_ALG_SHA_256));
	psa_set_key_lifetime(&attributes, PSA_KEY_LIFETIME_VOLATILE);

	zassert_equal(PSA_SUCCESS,
		      psa_import_key(&attributes, ikm, length, &key_id));

	return key_id;
}

/**
 * \brief Fingerprint a derived key by tagging a fixed message with it.
 *
 *        Derived keys are not exportable, so this is how two of them are
 *        compared for equality.
 */
static void key_fingerprint(psa_key_id_t key_id, uint8_t *tag, size_t tag_size)
{
	static const uint8_t message[] = "fingerprint";
	size_t tag_length = 0;

	zassert_true(UBI_HEADER_TAG_SIZE <= tag_size);

	zassert_equal(PSA_SUCCESS, psa_mac_compute(key_id, PSA_ALG_CMAC,
						   message, sizeof(message) - 1,
						   tag, tag_size, &tag_length));
	zassert_equal(UBI_HEADER_TAG_SIZE, tag_length);
}

/**
 * \brief Recompute the CRC so that only the tag can flag a change.
 */
static void fix_crc(uint8_t *buffer)
{
	sys_put_be32(crc32_ieee(buffer, HEADER_CRC_OFFSET),
		     &buffer[HEADER_CRC_OFFSET]);
}

static void *suite_setup(void)
{
	zassert_equal(PSA_SUCCESS, psa_crypto_init());

	ikm_key = import_ikm(test_ikm, sizeof(test_ikm), PSA_KEY_USAGE_DERIVE);

	zassert_ok(ubi_key_derive(ikm_key, &key_header, &key_volume_table));

	return NULL;
}

static void suite_teardown(void *fixture)
{
	ARG_UNUSED(fixture);

	ubi_key_destroy(&key_header);
	ubi_key_destroy(&key_volume_table);
	ubi_key_destroy(&ikm_key);
}

ZTEST_SUITE(ubi_unit, NULL, suite_setup, NULL, NULL, suite_teardown);

/* Tests: serialization round trip ----------------------------------------- */

ZTEST(ubi_unit, test_ec_header_roundtrip)
{
	const struct ubi_ec_header written = {
		.erase_count = 0x0123456789ABCDEFULL,
		.image_seq = TEST_IMAGE_SEQ,
		.vid_header_offset = UBI_VID_HEADER_OFFSET,
		.data_offset = UBI_DATA_OFFSET,
	};
	struct ubi_ec_header read = { 0 };
	uint8_t buffer[UBI_HEADER_SIZE] = { 0 };

	zassert_ok(ubi_ec_header_serialize(&written, key_header, TEST_PNUM,
					   buffer, sizeof(buffer)));
	zassert_equal(UBI_HEADER_OK,
		      ubi_ec_header_parse(buffer, sizeof(buffer), key_header,
					  TEST_PNUM, TEST_ERASE_VALUE, &read));

	zassert_equal(written.erase_count, read.erase_count);
	zassert_equal(written.image_seq, read.image_seq);
	zassert_equal(written.vid_header_offset, read.vid_header_offset);
	zassert_equal(written.data_offset, read.data_offset);
}

ZTEST(ubi_unit, test_vid_header_roundtrip)
{
	const struct ubi_vid_header written = {
		.sqnum = 0xFEDCBA9876543210ULL,
		.vol_id = 3,
		.lnum = 41,
		.image_seq = TEST_IMAGE_SEQ,
		.data_size = 1234,
		.data_crc = 0xDEADBEEFUL,
		.copy_flag = true,
	};
	struct ubi_vid_header read = { 0 };
	uint8_t buffer[UBI_HEADER_SIZE] = { 0 };

	zassert_ok(ubi_vid_header_serialize(&written, key_header, TEST_PNUM,
					    buffer, sizeof(buffer)));
	zassert_equal(UBI_HEADER_OK,
		      ubi_vid_header_parse(buffer, sizeof(buffer), key_header,
					   TEST_PNUM, TEST_ERASE_VALUE, &read));

	zassert_equal(written.sqnum, read.sqnum);
	zassert_equal(written.vol_id, read.vol_id);
	zassert_equal(written.lnum, read.lnum);
	zassert_equal(written.image_seq, read.image_seq);
	zassert_equal(written.data_size, read.data_size);
	zassert_equal(written.data_crc, read.data_crc);
	zassert_true(read.copy_flag);
}

ZTEST(ubi_unit, test_erased_block_has_no_header)
{
	zassert_equal(UBI_HEADER_ERASED,
		      ubi_ec_header_parse(erased_block, sizeof(erased_block),
					  key_header, TEST_PNUM,
					  TEST_ERASE_VALUE, NULL));
	zassert_equal(UBI_HEADER_ERASED,
		      ubi_vid_header_parse(erased_block, sizeof(erased_block),
					   key_header, TEST_PNUM,
					   TEST_ERASE_VALUE, NULL));
}

ZTEST(ubi_unit, test_blankness_follows_the_flash_erase_value)
{
	uint8_t zeroed_block[UBI_HEADER_SIZE] = { 0 };

	/* A flash that erases to zero must not be told that its blank blocks
	 * hold something, nor that a block of 0xFF is blank. */
	zassert_equal(UBI_HEADER_ERASED,
		      ubi_ec_header_parse(zeroed_block, sizeof(zeroed_block),
					  key_header, TEST_PNUM, 0x00, NULL));
	zassert_not_equal(UBI_HEADER_ERASED,
			  ubi_ec_header_parse(erased_block,
					      sizeof(erased_block), key_header,
					      TEST_PNUM, 0x00, NULL));
}

/* Tests: the on-flash layout is a contract -------------------------------- */

ZTEST(ubi_unit, test_ec_layout_is_pinned)
{
	const struct ubi_ec_header header = {
		.erase_count = 0x0011223344556677ULL,
		.image_seq = 0x8899AABBUL,
		.vid_header_offset = UBI_VID_HEADER_OFFSET,
		.data_offset = UBI_DATA_OFFSET,
	};
	uint8_t buffer[UBI_HEADER_SIZE] = { 0 };

	zassert_ok(ubi_ec_header_serialize(&header, key_header, TEST_PNUM,
					   buffer, sizeof(buffer)));

	/* Every field Linux UBI interprets sits where Linux puts it. */
	zassert_equal(0x55424923UL, sys_get_be32(&buffer[0x00]), "magic");
	zassert_equal(1, buffer[0x04], "version");
	zassert_equal(header.erase_count, sys_get_be64(&buffer[0x08]), "ec");
	zassert_equal(UBI_VID_HEADER_OFFSET, sys_get_be32(&buffer[0x10]));
	zassert_equal(UBI_DATA_OFFSET, sys_get_be32(&buffer[0x14]));
	zassert_equal(header.image_seq, sys_get_be32(&buffer[0x18]));
	zassert_equal(crc32_ieee(buffer, 0x3C), sys_get_be32(&buffer[0x3C]));
}

ZTEST(ubi_unit, test_vid_layout_is_pinned)
{
	const struct ubi_vid_header header = {
		.sqnum = 0x0011223344556677ULL,
		.vol_id = 0x01020304UL,
		.lnum = 0x05060708UL,
		.image_seq = 0x8899AABBUL,
		.data_size = 0x0A0B0C0DUL,
		.data_crc = 0x0E0F1011UL,
		.copy_flag = true,
	};
	uint8_t buffer[UBI_HEADER_SIZE] = { 0 };

	zassert_ok(ubi_vid_header_serialize(&header, key_header, TEST_PNUM,
					    buffer, sizeof(buffer)));

	zassert_equal(0x55424921UL, sys_get_be32(&buffer[0x00]), "magic");
	zassert_equal(1, buffer[0x04], "version");
	zassert_equal(1, buffer[0x05], "vol_type is always dynamic");
	zassert_equal(1, buffer[0x06], "copy_flag");
	zassert_equal(0, buffer[0x07], "compat");
	zassert_equal(header.vol_id, sys_get_be32(&buffer[0x08]));
	zassert_equal(header.lnum, sys_get_be32(&buffer[0x0C]));
	zassert_equal(header.image_seq, sys_get_be32(&buffer[0x10]));
	zassert_equal(header.data_size, sys_get_be32(&buffer[0x14]));
	zassert_equal(header.sqnum, sys_get_be64(&buffer[0x28]));
	zassert_equal(header.data_crc, sys_get_be32(&buffer[0x30]));
	zassert_equal(crc32_ieee(buffer, 0x3C), sys_get_be32(&buffer[0x3C]));
}

ZTEST(ubi_unit, test_authentic_header_with_foreign_layout_is_refused)
{
	const struct ubi_ec_header header = {
		.erase_count = 1,
		.image_seq = TEST_IMAGE_SEQ,
		.vid_header_offset = 512,
		.data_offset = 1024,
	};
	uint8_t buffer[UBI_HEADER_SIZE] = { 0 };

	zassert_ok(ubi_ec_header_serialize(&header, key_header, TEST_PNUM,
					   buffer, sizeof(buffer)));

	/* The tag verifies, but this build cannot address that layout. */
	zassert_equal(UBI_HEADER_NOT_UBI,
		      ubi_ec_header_parse(buffer, sizeof(buffer), key_header,
					  TEST_PNUM, TEST_ERASE_VALUE, NULL));
}

/* Tests: damage versus tampering ------------------------------------------ */

ZTEST(ubi_unit, test_crc_reports_damage)
{
	const struct ubi_ec_header header = { .erase_count = 1 };
	uint8_t buffer[UBI_HEADER_SIZE] = { 0 };

	zassert_ok(ubi_ec_header_serialize(&header, key_header, TEST_PNUM,
					   buffer, sizeof(buffer)));

	/* A byte flips and nobody fixes the checksum: that is damage. */
	buffer[EC_ERASE_COUNT_OFFSET] ^= 0x01;

	zassert_equal(UBI_HEADER_CORRUPT,
		      ubi_ec_header_parse(buffer, sizeof(buffer), key_header,
					  TEST_PNUM, TEST_ERASE_VALUE, NULL));
}

ZTEST(ubi_unit, test_tag_reports_tampering_of_every_byte)
{
	const struct ubi_ec_header header = {
		.erase_count = 99,
		.image_seq = TEST_IMAGE_SEQ,
		.vid_header_offset = UBI_VID_HEADER_OFFSET,
		.data_offset = UBI_DATA_OFFSET,
	};
	uint8_t original[UBI_HEADER_SIZE] = { 0 };

	zassert_ok(ubi_ec_header_serialize(&header, key_header, TEST_PNUM,
					   original, sizeof(original)));

	/*
	 * Flip one bit at a time across everything the CRC covers, repairing
	 * the CRC each round so that only the tag can object. Magic is checked
	 * before the tag, so those four bytes report a foreign block instead.
	 */
	for (size_t i = 0; i < HEADER_CRC_OFFSET; ++i) {
		const enum ubi_header_status expected =
			(i < sizeof(uint32_t)) ? UBI_HEADER_NOT_UBI :
						 UBI_HEADER_TAMPERED;
		uint8_t buffer[UBI_HEADER_SIZE] = { 0 };

		memcpy(buffer, original, sizeof(buffer));
		buffer[i] ^= 0x01;
		fix_crc(buffer);

		zassert_equal(expected,
			      ubi_ec_header_parse(buffer, sizeof(buffer),
						  key_header, TEST_PNUM,
						  TEST_ERASE_VALUE, NULL),
			      "byte %zu escaped detection", i);
	}
}

/* Tests: what the tag binds ----------------------------------------------- */

ZTEST(ubi_unit, test_tag_binds_the_block_number)
{
	const struct ubi_ec_header header = { .erase_count = 5 };
	uint8_t buffer[UBI_HEADER_SIZE] = { 0 };

	zassert_ok(ubi_ec_header_serialize(&header, key_header, TEST_PNUM,
					   buffer, sizeof(buffer)));

	/* Byte-for-byte identical, read from a different block: rejected. */
	zassert_equal(UBI_HEADER_TAMPERED,
		      ubi_ec_header_parse(buffer, sizeof(buffer), key_header,
					  TEST_PNUM + 1, TEST_ERASE_VALUE,
					  NULL));
}

ZTEST(ubi_unit, test_header_and_volume_table_keys_are_separate)
{
	const struct ubi_ec_header header = { .erase_count = 5 };
	uint8_t buffer[UBI_HEADER_SIZE] = { 0 };

	zassert_ok(ubi_ec_header_serialize(&header, key_volume_table, TEST_PNUM,
					   buffer, sizeof(buffer)));

	zassert_equal(UBI_HEADER_TAMPERED,
		      ubi_ec_header_parse(buffer, sizeof(buffer), key_header,
					  TEST_PNUM, TEST_ERASE_VALUE, NULL));
}

ZTEST(ubi_unit, test_vid_tag_does_not_pass_as_ec)
{
	const struct ubi_vid_header header = { .vol_id = 1, .lnum = 0 };
	uint8_t buffer[UBI_HEADER_SIZE] = { 0 };

	zassert_ok(ubi_vid_header_serialize(&header, key_header, TEST_PNUM,
					    buffer, sizeof(buffer)));

	/* The magic sits inside the authenticated input, so the two header
	 * kinds can never be confused for one another. */
	zassert_equal(UBI_HEADER_NOT_UBI,
		      ubi_ec_header_parse(buffer, sizeof(buffer), key_header,
					  TEST_PNUM, TEST_ERASE_VALUE, NULL));
}

/* Tests: the argument contract -------------------------------------------- */

ZTEST(ubi_unit, test_short_buffer_is_refused)
{
	const struct ubi_ec_header header = { .erase_count = 1 };
	uint8_t buffer[UBI_HEADER_SIZE] = { 0 };

	zassert_equal(-EINVAL,
		      ubi_ec_header_serialize(&header, key_header, TEST_PNUM,
					      buffer, UBI_HEADER_SIZE - 1));
	zassert_equal(-EINVAL,
		      ubi_vid_header_serialize(NULL, key_header, TEST_PNUM,
					       buffer, sizeof(buffer)));
	zassert_equal(UBI_HEADER_ERROR,
		      ubi_ec_header_parse(buffer, UBI_HEADER_SIZE - 1,
					  key_header, TEST_PNUM,
					  TEST_ERASE_VALUE, NULL));
	zassert_equal(UBI_HEADER_ERROR,
		      ubi_vid_header_parse(NULL, sizeof(buffer), key_header,
					   TEST_PNUM, TEST_ERASE_VALUE, NULL));
}

ZTEST(ubi_unit, test_absent_key_is_refused)
{
	const struct ubi_ec_header header = { .erase_count = 1 };
	uint8_t buffer[UBI_HEADER_SIZE] = { 0 };

	zassert_equal(-EINVAL, ubi_ec_header_serialize(&header, PSA_KEY_ID_NULL,
						       TEST_PNUM, buffer,
						       sizeof(buffer)));
	zassert_equal(UBI_HEADER_ERROR,
		      ubi_vid_header_parse(buffer, sizeof(buffer),
					   PSA_KEY_ID_NULL, TEST_PNUM,
					   TEST_ERASE_VALUE, NULL));
}

/* Tests: key derivation --------------------------------------------------- */

ZTEST(ubi_unit, test_derivation_is_deterministic)
{
	psa_key_id_t again_header = PSA_KEY_ID_NULL;
	psa_key_id_t again_volume_table = PSA_KEY_ID_NULL;
	uint8_t first[UBI_HEADER_TAG_SIZE] = { 0 };
	uint8_t second[UBI_HEADER_TAG_SIZE] = { 0 };

	zassert_ok(ubi_key_derive(ikm_key, &again_header, &again_volume_table));

	key_fingerprint(key_header, first, sizeof(first));
	key_fingerprint(again_header, second, sizeof(second));
	zassert_mem_equal(first, second, sizeof(first));

	key_fingerprint(key_volume_table, first, sizeof(first));
	key_fingerprint(again_volume_table, second, sizeof(second));
	zassert_mem_equal(first, second, sizeof(first));

	ubi_key_destroy(&again_header);
	ubi_key_destroy(&again_volume_table);
}

ZTEST(ubi_unit, test_derivation_separates_its_two_labels)
{
	uint8_t of_header[UBI_HEADER_TAG_SIZE] = { 0 };
	uint8_t of_volume_table[UBI_HEADER_TAG_SIZE] = { 0 };

	key_fingerprint(key_header, of_header, sizeof(of_header));
	key_fingerprint(key_volume_table, of_volume_table,
			sizeof(of_volume_table));

	zassert_true(0 !=
		     memcmp(of_header, of_volume_table, sizeof(of_header)));
}

ZTEST(ubi_unit, test_derivation_follows_the_key_material)
{
	uint8_t other_ikm[sizeof(test_ikm)] = { 0 };
	psa_key_id_t other_key = PSA_KEY_ID_NULL;
	psa_key_id_t other_header = PSA_KEY_ID_NULL;
	psa_key_id_t other_volume_table = PSA_KEY_ID_NULL;
	uint8_t original[UBI_HEADER_TAG_SIZE] = { 0 };
	uint8_t derived[UBI_HEADER_TAG_SIZE] = { 0 };

	memcpy(other_ikm, test_ikm, sizeof(other_ikm));
	other_ikm[0] ^= 0x01;
	other_key =
		import_ikm(other_ikm, sizeof(other_ikm), PSA_KEY_USAGE_DERIVE);

	zassert_ok(
		ubi_key_derive(other_key, &other_header, &other_volume_table));

	key_fingerprint(key_header, original, sizeof(original));
	key_fingerprint(other_header, derived, sizeof(derived));

	/* One bit of input keying material must change everything. */
	zassert_true(0 != memcmp(original, derived, sizeof(original)));

	ubi_key_destroy(&other_header);
	ubi_key_destroy(&other_volume_table);
	ubi_key_destroy(&other_key);
}

ZTEST(ubi_unit, test_derivation_rejects_a_key_it_may_not_use)
{
	psa_key_id_t wrong =
		import_ikm(test_ikm, sizeof(test_ikm), PSA_KEY_USAGE_EXPORT);
	psa_key_id_t derived_header = PSA_KEY_ID_NULL;
	psa_key_id_t derived_volume_table = PSA_KEY_ID_NULL;

	zassert_equal(-EACCES, ubi_key_derive(wrong, &derived_header,
					      &derived_volume_table));
	zassert_equal(PSA_KEY_ID_NULL, derived_header);
	zassert_equal(PSA_KEY_ID_NULL, derived_volume_table);

	ubi_key_destroy(&wrong);
}

ZTEST(ubi_unit, test_derivation_rejects_an_absent_key)
{
	psa_key_id_t derived_header = PSA_KEY_ID_NULL;
	psa_key_id_t derived_volume_table = PSA_KEY_ID_NULL;

	zassert_equal(-EINVAL, ubi_key_derive(PSA_KEY_ID_NULL, &derived_header,
					      &derived_volume_table));
	zassert_equal(-EINVAL,
		      ubi_key_derive(ikm_key, NULL, &derived_volume_table));
}
```

## src/common.c
```c
/**
 * \file    common.c
 * \author  Kamil Kielbasa
 * \brief   Fixed inputs and the few helpers the unit tests share.
 *
 * \copyright Copyright (c) 2026
 *
 */

/* Include files ----------------------------------------------------------- */

/* Zephyr headers: */
#include <zephyr/sys/byteorder.h>
#include <zephyr/sys/crc.h>
#include <zephyr/ztest.h>

/* PSA headers: */
#include <psa/crypto.h>

/* UBI headers: */
#include "ubi_header.h"
#include "ubi_key.h"

/* Test headers: */
#include "common.h"

/* Module variables and constants ------------------------------------------ */

const uint8_t test_ikm[32] = {
	0x00, 0x01, 0x02, 0x03, 0x04, 0x05, 0x06, 0x07, 0x08, 0x09, 0x0A,
	0x0B, 0x0C, 0x0D, 0x0E, 0x0F, 0x10, 0x11, 0x12, 0x13, 0x14, 0x15,
	0x16, 0x17, 0x18, 0x19, 0x1A, 0x1B, 0x1C, 0x1D, 0x1E, 0x1F,
};

const uint8_t erased_block[UBI_HEADER_SIZE] = {
	[0 ...(UBI_HEADER_SIZE - 1)] = 0xFF,
};

/* Module interface function definitions ----------------------------------- */

psa_key_id_t import_ikm(const uint8_t *ikm, size_t length,
			psa_key_usage_t usage)
{
	psa_key_attributes_t attributes = PSA_KEY_ATTRIBUTES_INIT;
	psa_key_id_t key_id = PSA_KEY_ID_NULL;

	psa_set_key_type(&attributes, PSA_KEY_TYPE_DERIVE);
	psa_set_key_usage_flags(&attributes, usage);
	psa_set_key_algorithm(&attributes, PSA_ALG_HKDF(PSA_ALG_SHA_256));
	psa_set_key_lifetime(&attributes, PSA_KEY_LIFETIME_VOLATILE);

	zassert_equal(PSA_SUCCESS,
		      psa_import_key(&attributes, ikm, length, &key_id));

	return key_id;
}

void key_fingerprint(psa_key_id_t key_id, uint8_t *MAC, size_t mac_size)
{
	static const uint8_t message[] = "fingerprint";
	size_t mac_length = 0;

	zassert_true(UBI_MAC_SIZE <= mac_size);

	zassert_equal(PSA_SUCCESS, psa_mac_compute(key_id, PSA_ALG_CMAC,
						   message, sizeof(message) - 1,
						   MAC, mac_size, &mac_length));
	zassert_equal(UBI_MAC_SIZE, mac_length);
}

void fix_crc(uint8_t *buffer)
{
	sys_put_be32(crc32_ieee(buffer, HEADER_CRC_OFFSET),
		     &buffer[HEADER_CRC_OFFSET]);
}
```

## src/common.h
```c
/**
 * \file    common.h
 * \author  Kamil Kielbasa
 * \brief   Fixed inputs and the few helpers the unit tests share.
 *
 *          Neither header serialization nor key derivation has a public API
 *          of its own, so the tests reach them through the library's internal
 *          headers. Nothing is added to the library to make it testable.
 *
 * \copyright Copyright (c) 2026
 *
 */

/* Header guard ------------------------------------------------------------ */
#ifndef COMMON_H
#define COMMON_H

/* Include files ----------------------------------------------------------- */

/* Standard library headers: */
#include <stddef.h>
#include <stdint.h>

/* PSA headers: */
#include <psa/crypto.h>

/* UBI headers: */
#include "ubi_header.h"

/* Defines ----------------------------------------------------------------- */

/** Offset of the CRC within either header. */
#define HEADER_CRC_OFFSET (0x3C)

/** A byte inside the erase counter field, safe to flip in tests. */
#define EC_ERASE_COUNT_OFFSET (0x08)

/** Arbitrary but fixed block number for tests that do not vary it. */
#define TEST_PNUM (7)

/** Arbitrary but fixed image sequence number. */
#define TEST_IMAGE_SEQ (0xA5A5F00DUL)

/** Byte an erase leaves behind on the flash these tests pretend to use. */
#define TEST_ERASE_VALUE (0xFF)

/* Variable declarations --------------------------------------------------- */

/** Keying material every derivation in the suite starts from. */
extern const uint8_t test_ikm[32];

/** A block straight out of an erase. */
extern const uint8_t erased_block[UBI_HEADER_SIZE];

/* Function declarations --------------------------------------------------- */

/**
 * \brief Import keying material as a PSA derivation key.
 */
psa_key_id_t import_ikm(const uint8_t *ikm, size_t length,
			psa_key_usage_t usage);

/**
 * \brief Fingerprint a derived key by authenticating a fixed message with it.
 *
 *        Derived keys are not exportable, so this is how two of them are
 *        compared for equality.
 */
void key_fingerprint(psa_key_id_t key_id, uint8_t *MAC, size_t mac_size);

/**
 * \brief Recompute the CRC so that only the MAC can flag a change.
 */
void fix_crc(uint8_t *buffer);

#endif /* COMMON_H */
```

## src/headers.c
```c
/**
 * \file    headers.c
 * \author  Kamil Kielbasa
 * \brief   Fixed header inputs and the byte-level helper the unit tests
 *          share.
 *
 * \copyright Copyright (c) 2026
 *
 */

/* Include files ----------------------------------------------------------- */

/* Zephyr headers: */
#include <zephyr/sys/byteorder.h>
#include <zephyr/sys/crc.h>

/* UBI headers: */
#include "ubi_header.h"

/* Test headers: */
#include "headers.h"

/* Module variables and constants ------------------------------------------ */

const uint8_t erased_block[UBI_HEADER_SIZE] = {
	[0 ...(UBI_HEADER_SIZE - 1)] = 0xFF,
};

/* Module interface function definitions ----------------------------------- */

void fix_crc(uint8_t *buffer)
{
	sys_put_be32(crc32_ieee(buffer, HEADER_CRC_OFFSET),
		     &buffer[HEADER_CRC_OFFSET]);
}
```

## src/headers.h
```c
/**
 * \file    headers.h
 * \author  Kamil Kielbasa
 * \brief   Fixed header inputs and the byte-level helper the unit tests
 *          share.
 *
 *          Header serialization has no public API, so the tests reach it
 *          through the library's internal headers.
 *
 * \copyright Copyright (c) 2026
 *
 */

/* Header guard ------------------------------------------------------------ */
#ifndef HEADERS_H
#define HEADERS_H

/* Include files ----------------------------------------------------------- */

/* Standard library headers: */
#include <stdint.h>

/* UBI headers: */
#include "ubi_header.h"

/* Defines ----------------------------------------------------------------- */

/** Offset of the CRC within either header. */
#define HEADER_CRC_OFFSET (0x3C)

/** A byte inside the erase counter field, safe to flip in tests. */
#define EC_ERASE_COUNT_OFFSET (0x08)

/** Arbitrary but fixed block number for tests that do not vary it. */
#define TEST_PNUM (7)

/** Arbitrary but fixed image sequence number. */
#define TEST_IMAGE_SEQ (0xA5A5F00DUL)

/** Byte an erase leaves behind on the flash these tests pretend to use. */
#define TEST_ERASE_VALUE (0xFF)

/* Variable declarations --------------------------------------------------- */

/** A block straight out of an erase. */
extern const uint8_t erased_block[UBI_HEADER_SIZE];

/* Function declarations --------------------------------------------------- */

/**
 * \brief Recompute the CRC so that only the MAC can flag a change.
 */
void fix_crc(uint8_t *buffer);

#endif /* HEADERS_H */
```

## src/keys.c
```c
/**
 * \file    keys.c
 * \author  Kamil Kielbasa
 * \brief   Keying material and key helpers the unit tests share.
 *
 * \copyright Copyright (c) 2026
 *
 */

/* Include files ----------------------------------------------------------- */

/* Zephyr headers: */
#include <zephyr/ztest.h>

/* PSA headers: */
#include <psa/crypto.h>

/* UBI headers: */
#include "ubi_key.h"

/* Test headers: */
#include "keys.h"

/* Module variables and constants ------------------------------------------ */

const uint8_t test_ikm[32] = {
	0x00, 0x01, 0x02, 0x03, 0x04, 0x05, 0x06, 0x07, 0x08, 0x09, 0x0A,
	0x0B, 0x0C, 0x0D, 0x0E, 0x0F, 0x10, 0x11, 0x12, 0x13, 0x14, 0x15,
	0x16, 0x17, 0x18, 0x19, 0x1A, 0x1B, 0x1C, 0x1D, 0x1E, 0x1F,
};

/* Module interface function definitions ----------------------------------- */

psa_key_id_t import_ikm(const uint8_t *ikm, size_t length,
			psa_key_usage_t usage)
{
	psa_key_attributes_t attributes = PSA_KEY_ATTRIBUTES_INIT;
	psa_key_id_t key_id = PSA_KEY_ID_NULL;

	psa_set_key_type(&attributes, PSA_KEY_TYPE_DERIVE);
	psa_set_key_usage_flags(&attributes, usage);
	psa_set_key_algorithm(&attributes, PSA_ALG_HKDF(PSA_ALG_SHA_256));
	psa_set_key_lifetime(&attributes, PSA_KEY_LIFETIME_VOLATILE);

	zassert_equal(PSA_SUCCESS,
		      psa_import_key(&attributes, ikm, length, &key_id));

	return key_id;
}

void key_fingerprint(psa_key_id_t key_id, uint8_t *MAC, size_t mac_size)
{
	static const uint8_t message[] = "fingerprint";
	size_t mac_length = 0;

	zassert_true(UBI_MAC_SIZE <= mac_size);

	zassert_equal(PSA_SUCCESS, psa_mac_compute(key_id, PSA_ALG_CMAC,
						   message, sizeof(message) - 1,
						   MAC, mac_size, &mac_length));
	zassert_equal(UBI_MAC_SIZE, mac_length);
}
```

## src/keys.h
```c
/**
 * \file    keys.h
 * \author  Kamil Kielbasa
 * \brief   Keying material and key helpers the unit tests share.
 *
 * \copyright Copyright (c) 2026
 *
 */

/* Header guard ------------------------------------------------------------ */
#ifndef KEYS_H
#define KEYS_H

/* Include files ----------------------------------------------------------- */

/* Standard library headers: */
#include <stddef.h>
#include <stdint.h>

/* PSA headers: */
#include <psa/crypto.h>

/* Variable declarations --------------------------------------------------- */

/** Keying material every derivation in the suite starts from. */
extern const uint8_t test_ikm[32];

/* Function declarations --------------------------------------------------- */

/**
 * \brief Import keying material as a PSA derivation key.
 */
psa_key_id_t import_ikm(const uint8_t *ikm, size_t length,
			psa_key_usage_t usage);

/**
 * \brief Fingerprint a derived key by authenticating a fixed message with it.
 *
 *        Derived keys are not exportable, so this is how two of them are
 *        compared for equality.
 */
void key_fingerprint(psa_key_id_t key_id, uint8_t *MAC, size_t mac_size);

#endif /* KEYS_H */
```

## src/suite.c
```c
/**
 * \file    suite.c
 * \author  Kamil Kielbasa
 * \brief   The unit suite: one crypto init and one derivation for all of it.
 *
 * \copyright Copyright (c) 2026
 *
 */

/* Include files ----------------------------------------------------------- */

/* Zephyr headers: */
#include <zephyr/ztest.h>

/* PSA headers: */
#include <psa/crypto.h>

/* UBI headers: */
#include "ubi_key.h"

/* Test headers: */
#include "keys.h"
#include "suite.h"

/* Module variables and constants ------------------------------------------ */

psa_key_id_t ikm_key;
psa_key_id_t key_header;
psa_key_id_t key_volume_table;

/* Static function declarations -------------------------------------------- */

/**
 * \brief Bring up the crypto backend and derive the keys every test uses.
 */
static void *suite_setup(void);

/**
 * \brief Destroy them.
 */
static void suite_teardown(void *fixture);

/* Static function definitions --------------------------------------------- */

static void *suite_setup(void)
{
	zassert_equal(PSA_SUCCESS, psa_crypto_init());

	ikm_key = import_ikm(test_ikm, sizeof(test_ikm), PSA_KEY_USAGE_DERIVE);

	zassert_ok(ubi_impl_key_derive(ikm_key, NULL, 0, &key_header,
				       &key_volume_table));

	return NULL;
}

static void suite_teardown(void *fixture)
{
	ARG_UNUSED(fixture);

	ubi_impl_key_destroy(&key_header);
	ubi_impl_key_destroy(&key_volume_table);
	ubi_impl_key_destroy(&ikm_key);
}

ZTEST_SUITE(ubi_unit, NULL, suite_setup, NULL, NULL, suite_teardown);
```

## src/suite.h
```c
/**
 * \file    suite.h
 * \author  Kamil Kielbasa
 * \brief   The keys the suite derives once and every test leans on.
 *
 * \copyright Copyright (c) 2026
 *
 */

/* Header guard ------------------------------------------------------------ */
#ifndef SUITE_H
#define SUITE_H

/* Include files ----------------------------------------------------------- */

/* PSA headers: */
#include <psa/crypto.h>

/* Variable declarations --------------------------------------------------- */

/** The PSA key holding the suite's keying material. */
extern psa_key_id_t ikm_key;

/** Key the headers are authenticated with, derived from it. */
extern psa_key_id_t key_header;

/** Key the volume table record is authenticated with. */
extern psa_key_id_t key_volume_table;

#endif /* SUITE_H */
```

## src/test_header.c
```c
/**
 * \file    test_header.c
 * \author  Kamil Kielbasa
 * \brief   Serializing a header, parsing it back, and the layout it pins.
 *
 * \copyright Copyright (c) 2026
 *
 */

/* Include files ----------------------------------------------------------- */

/* Standard library headers: */
#include <errno.h>
#include <string.h>

/* Zephyr headers: */
#include <zephyr/sys/byteorder.h>
#include <zephyr/sys/crc.h>
#include <zephyr/ztest.h>

/* PSA headers: */
#include <psa/crypto.h>

/* UBI headers: */
#include "ubi_header.h"
#include "ubi_key.h"

/* Test headers: */
#include "headers.h"
#include "suite.h"

/* Module interface function definitions ----------------------------------- */

ZTEST(ubi_unit, test_ec_header_roundtrip)
{
	const struct ubi_ec_header written = {
		.erase_count = 0x0123456789ABCDEFULL,
		.image_seq = TEST_IMAGE_SEQ,
		.vid_header_offset = UBI_VID_HEADER_OFFSET,
		.data_offset = UBI_DATA_OFFSET,
	};
	struct ubi_ec_header read = { 0 };
	uint8_t buffer[UBI_HEADER_SIZE] = { 0 };

	zassert_ok(ubi_impl_header_ec_serialize(&written, key_header, TEST_PNUM,
						buffer, sizeof(buffer)));
	zassert_equal(UBI_HEADER_OK,
		      ubi_impl_header_ec_parse(buffer, sizeof(buffer),
					       key_header, TEST_PNUM,
					       TEST_ERASE_VALUE, &read));

	zassert_equal(written.erase_count, read.erase_count);
	zassert_equal(written.image_seq, read.image_seq);
	zassert_equal(written.vid_header_offset, read.vid_header_offset);
	zassert_equal(written.data_offset, read.data_offset);
}

ZTEST(ubi_unit, test_vid_header_roundtrip)
{
	const struct ubi_vid_header written = {
		.sqnum = 0xFEDCBA9876543210ULL,
		.vol_id = 3,
		.lnum = 41,
		.image_seq = TEST_IMAGE_SEQ,
		.data_size = 1234,
		.data_crc = 0xDEADBEEFUL,
		.copy_flag = true,
	};
	struct ubi_vid_header read = { 0 };
	uint8_t buffer[UBI_HEADER_SIZE] = { 0 };

	zassert_ok(ubi_impl_header_vid_serialize(
		&written, key_header, TEST_PNUM, buffer, sizeof(buffer)));
	zassert_equal(UBI_HEADER_OK,
		      ubi_impl_header_vid_parse(buffer, sizeof(buffer),
						key_header, TEST_PNUM,
						TEST_ERASE_VALUE, &read));

	zassert_equal(written.sqnum, read.sqnum);
	zassert_equal(written.vol_id, read.vol_id);
	zassert_equal(written.lnum, read.lnum);
	zassert_equal(written.image_seq, read.image_seq);
	zassert_equal(written.data_size, read.data_size);
	zassert_equal(written.data_crc, read.data_crc);
	zassert_true(read.copy_flag);
}

ZTEST(ubi_unit, test_erased_block_has_no_header)
{
	zassert_equal(UBI_HEADER_ERASED,
		      ubi_impl_header_ec_parse(
			      erased_block, sizeof(erased_block), key_header,
			      TEST_PNUM, TEST_ERASE_VALUE, NULL));
	zassert_equal(UBI_HEADER_ERASED,
		      ubi_impl_header_vid_parse(
			      erased_block, sizeof(erased_block), key_header,
			      TEST_PNUM, TEST_ERASE_VALUE, NULL));
}

ZTEST(ubi_unit, test_blankness_follows_the_flash_erase_value)
{
	uint8_t zeroed_block[UBI_HEADER_SIZE] = { 0 };

	/* A flash that erases to zero must not be told that its blank blocks
	 * hold something, nor that a block of 0xFF is blank. */
	zassert_equal(UBI_HEADER_ERASED,
		      ubi_impl_header_ec_parse(zeroed_block,
					       sizeof(zeroed_block), key_header,
					       TEST_PNUM, 0x00, NULL));
	zassert_not_equal(
		UBI_HEADER_ERASED,
		ubi_impl_header_ec_parse(erased_block, sizeof(erased_block),
					 key_header, TEST_PNUM, 0x00, NULL));
}

/* Tests: the on-flash layout is a contract -------------------------------- */

ZTEST(ubi_unit, test_ec_layout_is_pinned)
{
	const struct ubi_ec_header header = {
		.erase_count = 0x0011223344556677ULL,
		.image_seq = 0x8899AABBUL,
		.vid_header_offset = UBI_VID_HEADER_OFFSET,
		.data_offset = UBI_DATA_OFFSET,
	};
	uint8_t buffer[UBI_HEADER_SIZE] = { 0 };

	zassert_ok(ubi_impl_header_ec_serialize(&header, key_header, TEST_PNUM,
						buffer, sizeof(buffer)));

	/* Every field Linux UBI interprets sits where Linux puts it. */
	zassert_equal(0x55424923UL, sys_get_be32(&buffer[0x00]), "magic");
	zassert_equal(1, buffer[0x04], "version");
	zassert_equal(header.erase_count, sys_get_be64(&buffer[0x08]), "ec");
	zassert_equal(UBI_VID_HEADER_OFFSET, sys_get_be32(&buffer[0x10]));
	zassert_equal(UBI_DATA_OFFSET, sys_get_be32(&buffer[0x14]));
	zassert_equal(header.image_seq, sys_get_be32(&buffer[0x18]));
	zassert_equal(crc32_ieee(buffer, 0x3C), sys_get_be32(&buffer[0x3C]));
}

ZTEST(ubi_unit, test_vid_layout_is_pinned)
{
	const struct ubi_vid_header header = {
		.sqnum = 0x0011223344556677ULL,
		.vol_id = 0x01020304UL,
		.lnum = 0x05060708UL,
		.image_seq = 0x8899AABBUL,
		.data_size = 0x0A0B0C0DUL,
		.data_crc = 0x0E0F1011UL,
		.copy_flag = true,
	};
	uint8_t buffer[UBI_HEADER_SIZE] = { 0 };

	zassert_ok(ubi_impl_header_vid_serialize(&header, key_header, TEST_PNUM,
						 buffer, sizeof(buffer)));

	zassert_equal(0x55424921UL, sys_get_be32(&buffer[0x00]), "magic");
	zassert_equal(1, buffer[0x04], "version");
	zassert_equal(1, buffer[0x05], "vol_type is always dynamic");
	zassert_equal(1, buffer[0x06], "copy_flag");
	zassert_equal(0, buffer[0x07], "compat");
	zassert_equal(header.vol_id, sys_get_be32(&buffer[0x08]));
	zassert_equal(header.lnum, sys_get_be32(&buffer[0x0C]));
	zassert_equal(header.image_seq, sys_get_be32(&buffer[0x10]));
	zassert_equal(header.data_size, sys_get_be32(&buffer[0x14]));
	zassert_equal(header.sqnum, sys_get_be64(&buffer[0x28]));
	zassert_equal(header.data_crc, sys_get_be32(&buffer[0x30]));
	zassert_equal(crc32_ieee(buffer, 0x3C), sys_get_be32(&buffer[0x3C]));
}

ZTEST(ubi_unit, test_authentic_header_with_foreign_layout_is_refused)
{
	const struct ubi_ec_header header = {
		.erase_count = 1,
		.image_seq = TEST_IMAGE_SEQ,
		.vid_header_offset = 512,
		.data_offset = 1024,
	};
	uint8_t buffer[UBI_HEADER_SIZE] = { 0 };

	zassert_ok(ubi_impl_header_ec_serialize(&header, key_header, TEST_PNUM,
						buffer, sizeof(buffer)));

	/* The MAC verifies, but this build cannot address that layout, and it
	 * says so rather than calling the block foreign. */
	zassert_equal(UBI_HEADER_UNSUPPORTED,
		      ubi_impl_header_ec_parse(buffer, sizeof(buffer),
					       key_header, TEST_PNUM,
					       TEST_ERASE_VALUE, NULL));
}
```

## src/test_kat.c
```c
/**
 * \file    test_kat.c
 * \author  Kamil Kielbasa
 * \brief   Known answers: what reaches the flash, byte for byte.
 *
 *          The expected bytes come from scripts/kat.py, which follows
 *          docs/on-flash-format.md and shares no code with the library. A
 *          change that alters the key derivation or any byte of a header or
 *          a record fails here, even when writing and reading still agree
 *          with each other.
 *
 * \copyright Copyright (c) 2026
 *
 */

/* Include files ----------------------------------------------------------- */

/* Standard library headers: */
#include <string.h>

/* Zephyr headers: */
#include <zephyr/ztest.h>

/* PSA headers: */
#include <psa/crypto.h>

/* UBI headers: */
#include "ubi_header.h"
#include "ubi_key.h"
#include "ubi_volume_table.h"

/* Test headers: */
#include "headers.h"
#include "keys.h"
#include "suite.h"

/* Module defines ---------------------------------------------------------- */

/** Image every known answer belongs to. */
#define KAT_IMAGE_SEQ (0x12345678UL)

/* Module variables and constants ------------------------------------------ */

/** Context the bound keys below are derived under. */
static const uint8_t kat_key_context[] = "storage_partition";

/* python3 scripts/kat.py */

static const uint8_t kat_header_key_fingerprint[16] = {
	0xF9, 0x9A, 0xD0, 0xB9, 0x3D, 0x3E, 0x66, 0xE8,
	0xEF, 0x83, 0x0E, 0xE9, 0x6B, 0x75, 0x67, 0x6B,
};

static const uint8_t kat_volume_table_key_fingerprint[16] = {
	0xA4, 0x7F, 0xD5, 0x8F, 0x57, 0x81, 0x24, 0x7E,
	0x2B, 0xEE, 0x5E, 0xC4, 0x74, 0xF6, 0x08, 0x16,
};

static const uint8_t kat_ec_header[64] = {
	0x55, 0x42, 0x49, 0x23, 0x01, 0x00, 0x00, 0x00, 0x00, 0x00, 0x00,
	0x00, 0x00, 0x00, 0x00, 0x01, 0x00, 0x00, 0x00, 0x40, 0x00, 0x00,
	0x00, 0x80, 0x12, 0x34, 0x56, 0x78, 0x7C, 0x9A, 0x9A, 0xBD, 0x8A,
	0x25, 0xA6, 0xD7, 0xE8, 0x5E, 0xCE, 0x81, 0x84, 0x60, 0x5B, 0x86,
	0x00, 0x00, 0x00, 0x00, 0x00, 0x00, 0x00, 0x00, 0x00, 0x00, 0x00,
	0x00, 0x00, 0x00, 0x00, 0x00, 0x09, 0xDF, 0xE6, 0x8F,
};

static const uint8_t kat_vid_header[64] = {
	0x55, 0x42, 0x49, 0x21, 0x01, 0x01, 0x01, 0x00, 0x00, 0x00, 0x00,
	0x03, 0x00, 0x00, 0x00, 0x09, 0x12, 0x34, 0x56, 0x78, 0x00, 0x00,
	0x01, 0x00, 0xCE, 0x62, 0xBB, 0x88, 0xB1, 0xC8, 0x8B, 0x28, 0xB8,
	0xAF, 0x59, 0xEE, 0xEF, 0x51, 0xF9, 0x67, 0x01, 0x02, 0x03, 0x04,
	0x05, 0x06, 0x07, 0x08, 0xCA, 0xFE, 0xF0, 0x0D, 0x00, 0x00, 0x00,
	0x00, 0x00, 0x00, 0x00, 0x00, 0x01, 0x98, 0xF8, 0x1C,
};

static const uint8_t kat_volume_table_record[96] = {
	0x55, 0x42, 0x49, 0x56, 0x01, 0x00, 0x00, 0x00, 0x00, 0x00, 0x00, 0x07,
	0x12, 0x34, 0x56, 0x78, 0x00, 0x00, 0x10, 0x00, 0x00, 0x00, 0x08, 0x00,
	0x00, 0x00, 0x00, 0x03, 0x00, 0x00, 0x00, 0x02, 0x00, 0x00, 0x00, 0x00,
	0x00, 0x00, 0x00, 0x10, 0x6C, 0x6F, 0x67, 0x73, 0x00, 0x00, 0x00, 0x00,
	0x00, 0x00, 0x00, 0x00, 0x00, 0x00, 0x00, 0x00, 0x00, 0x00, 0x00, 0x02,
	0x00, 0x00, 0x00, 0x05, 0x30, 0x31, 0x32, 0x33, 0x34, 0x35, 0x36, 0x37,
	0x38, 0x39, 0x61, 0x62, 0x63, 0x64, 0x65, 0x00, 0x95, 0xA4, 0xD5, 0xF8,
	0xFB, 0xEA, 0x33, 0xB9, 0xB6, 0xB2, 0x82, 0x89, 0xDB, 0x40, 0x7D, 0xFB,
};

static const uint8_t kat_bound_header_key_fingerprint[16] = {
	0x25, 0xE8, 0x16, 0x40, 0xC1, 0x6F, 0x96, 0xFB,
	0x2D, 0xC7, 0x63, 0xB1, 0xF5, 0x10, 0x7B, 0x17,
};

static const uint8_t kat_bound_volume_table_key_fingerprint[16] = {
	0x0A, 0x4E, 0x00, 0xE0, 0x39, 0x46, 0xBC, 0x23,
	0xEF, 0xD5, 0xD5, 0x62, 0xA7, 0x9E, 0x23, 0x80,
};

/* Module interface function definitions ----------------------------------- */

ZTEST(ubi_unit, test_both_keys_are_the_ones_the_format_specifies)
{
	uint8_t fingerprint[UBI_MAC_SIZE] = { 0 };

	key_fingerprint(key_header, fingerprint, sizeof(fingerprint));
	zassert_mem_equal(kat_header_key_fingerprint, fingerprint,
			  sizeof(fingerprint));

	key_fingerprint(key_volume_table, fingerprint, sizeof(fingerprint));
	zassert_mem_equal(kat_volume_table_key_fingerprint, fingerprint,
			  sizeof(fingerprint));
}

ZTEST(ubi_unit, test_keys_under_a_context_are_the_ones_the_format_specifies)
{
	psa_key_id_t bound_header = PSA_KEY_ID_NULL;
	psa_key_id_t bound_volume_table = PSA_KEY_ID_NULL;
	uint8_t fingerprint[UBI_MAC_SIZE] = { 0 };

	zassert_ok(ubi_impl_key_derive(ikm_key, kat_key_context,
				       sizeof(kat_key_context) - 1,
				       &bound_header, &bound_volume_table));

	key_fingerprint(bound_header, fingerprint, sizeof(fingerprint));
	zassert_mem_equal(kat_bound_header_key_fingerprint, fingerprint,
			  sizeof(fingerprint));

	key_fingerprint(bound_volume_table, fingerprint, sizeof(fingerprint));
	zassert_mem_equal(kat_bound_volume_table_key_fingerprint, fingerprint,
			  sizeof(fingerprint));

	ubi_impl_key_destroy(&bound_header);
	ubi_impl_key_destroy(&bound_volume_table);
}

ZTEST(ubi_unit, test_an_ec_header_is_sealed_as_the_format_specifies)
{
	const struct ubi_ec_header header = {
		.erase_count = 1,
		.image_seq = KAT_IMAGE_SEQ,
		.vid_header_offset = UBI_VID_HEADER_OFFSET,
		.data_offset = UBI_DATA_OFFSET,
	};
	uint8_t buffer[UBI_HEADER_SIZE] = { 0 };

	zassert_ok(ubi_impl_header_ec_serialize(&header, key_header, TEST_PNUM,
						buffer, sizeof(buffer)));
	zassert_mem_equal(kat_ec_header, buffer, sizeof(buffer));
}

ZTEST(ubi_unit, test_a_vid_header_is_sealed_as_the_format_specifies)
{
	const struct ubi_vid_header header = {
		.sqnum = 0x0102030405060708ULL,
		.vol_id = 3,
		.lnum = 9,
		.image_seq = KAT_IMAGE_SEQ,
		.data_size = 256,
		.data_crc = 0xCAFEF00DUL,
		.copy_flag = true,
	};
	uint8_t buffer[UBI_HEADER_SIZE] = { 0 };

	zassert_ok(ubi_impl_header_vid_serialize(&header, key_header, TEST_PNUM,
						 buffer, sizeof(buffer)));
	zassert_mem_equal(kat_vid_header, buffer, sizeof(buffer));
}

ZTEST(ubi_unit, test_a_record_is_sealed_as_the_format_specifies)
{
	const struct ubi_volume_table_record record = {
		.revision = 7,
		.image_seq = KAT_IMAGE_SEQ,
		.peb_size = 4096,
		.peb_count = 2048,
		.vol_id_watermark = 3,
		.volume_count = 2,
		.entries = {
			{ .vol_id = 0, .leb_count = 16, .name = "logs" },
			{ .vol_id = 2, .leb_count = 5,
			  .name = "0123456789abcde" },
		},
	};
	uint8_t buffer[UBI_VOLUME_TABLE_RECORD_MAX_SIZE] = { 0 };
	size_t record_size = 0;

	zassert_ok(ubi_impl_volume_table_record_serialize(
		&record, key_volume_table, buffer, sizeof(buffer),
		&record_size));
	zassert_equal(sizeof(kat_volume_table_record), record_size);
	zassert_mem_equal(kat_volume_table_record, buffer, record_size);
}
```

## src/test_key.c
```c
/**
 * \file    test_key.c
 * \author  Kamil Kielbasa
 * \brief   Deriving the two keys from one piece of keying material.
 *
 * \copyright Copyright (c) 2026
 *
 */

/* Include files ----------------------------------------------------------- */

/* Standard library headers: */
#include <errno.h>
#include <string.h>

/* Zephyr headers: */
#include <zephyr/sys/byteorder.h>
#include <zephyr/sys/crc.h>
#include <zephyr/ztest.h>

/* PSA headers: */
#include <psa/crypto.h>

/* UBI headers: */
#include <ubi/ubi.h>

#include "ubi_header.h"
#include "ubi_key.h"

/* Test headers: */
#include "keys.h"
#include "suite.h"

/* Module interface function definitions ----------------------------------- */

ZTEST(ubi_unit, test_derivation_is_deterministic)
{
	psa_key_id_t again_header = PSA_KEY_ID_NULL;
	psa_key_id_t again_volume_table = PSA_KEY_ID_NULL;
	uint8_t first[UBI_MAC_SIZE] = { 0 };
	uint8_t second[UBI_MAC_SIZE] = { 0 };

	zassert_ok(ubi_impl_key_derive(ikm_key, NULL, 0, &again_header,
				       &again_volume_table));

	key_fingerprint(key_header, first, sizeof(first));
	key_fingerprint(again_header, second, sizeof(second));
	zassert_mem_equal(first, second, sizeof(first));

	key_fingerprint(key_volume_table, first, sizeof(first));
	key_fingerprint(again_volume_table, second, sizeof(second));
	zassert_mem_equal(first, second, sizeof(first));

	ubi_impl_key_destroy(&again_header);
	ubi_impl_key_destroy(&again_volume_table);
}

ZTEST(ubi_unit, test_derivation_separates_its_two_labels)
{
	uint8_t of_header[UBI_MAC_SIZE] = { 0 };
	uint8_t of_volume_table[UBI_MAC_SIZE] = { 0 };

	key_fingerprint(key_header, of_header, sizeof(of_header));
	key_fingerprint(key_volume_table, of_volume_table,
			sizeof(of_volume_table));

	zassert_true(0 !=
		     memcmp(of_header, of_volume_table, sizeof(of_header)));
}

ZTEST(ubi_unit, test_derivation_follows_the_key_material)
{
	uint8_t other_ikm[sizeof(test_ikm)] = { 0 };
	psa_key_id_t other_key = PSA_KEY_ID_NULL;
	psa_key_id_t other_header = PSA_KEY_ID_NULL;
	psa_key_id_t other_volume_table = PSA_KEY_ID_NULL;
	uint8_t original[UBI_MAC_SIZE] = { 0 };
	uint8_t derived[UBI_MAC_SIZE] = { 0 };

	memcpy(other_ikm, test_ikm, sizeof(other_ikm));
	other_ikm[0] ^= 0x01;
	other_key =
		import_ikm(other_ikm, sizeof(other_ikm), PSA_KEY_USAGE_DERIVE);

	zassert_ok(ubi_impl_key_derive(other_key, NULL, 0, &other_header,
				       &other_volume_table));

	key_fingerprint(key_header, original, sizeof(original));
	key_fingerprint(other_header, derived, sizeof(derived));

	/* One bit of input keying material must change everything. */
	zassert_true(0 != memcmp(original, derived, sizeof(original)));

	ubi_impl_key_destroy(&other_header);
	ubi_impl_key_destroy(&other_volume_table);
	ubi_impl_key_destroy(&other_key);
}

ZTEST(ubi_unit, test_derivation_rejects_a_key_it_may_not_use)
{
	psa_key_id_t wrong =
		import_ikm(test_ikm, sizeof(test_ikm), PSA_KEY_USAGE_EXPORT);
	psa_key_id_t derived_header = PSA_KEY_ID_NULL;
	psa_key_id_t derived_volume_table = PSA_KEY_ID_NULL;

	zassert_equal(-EACCES,
		      ubi_impl_key_derive(wrong, NULL, 0, &derived_header,
					  &derived_volume_table));
	zassert_equal(PSA_KEY_ID_NULL, derived_header);
	zassert_equal(PSA_KEY_ID_NULL, derived_volume_table);

	ubi_impl_key_destroy(&wrong);
}

ZTEST(ubi_unit, test_derivation_rejects_an_absent_key)
{
	psa_key_id_t derived_header = PSA_KEY_ID_NULL;
	psa_key_id_t derived_volume_table = PSA_KEY_ID_NULL;

	zassert_equal(-EINVAL, ubi_impl_key_derive(PSA_KEY_ID_NULL, NULL, 0,
						   &derived_header,
						   &derived_volume_table));
	zassert_equal(-EINVAL, ubi_impl_key_derive(ikm_key, NULL, 0, NULL,
						   &derived_volume_table));
}

ZTEST(ubi_unit, test_derivation_rejects_a_context_that_does_not_fit)
{
	uint8_t too_long[UBI_KEY_CONTEXT_MAX_SIZE + 1] = { 0 };
	psa_key_id_t derived_header = PSA_KEY_ID_NULL;
	psa_key_id_t derived_volume_table = PSA_KEY_ID_NULL;

	zassert_equal(-EINVAL, ubi_impl_key_derive(
				       ikm_key, too_long, sizeof(too_long),
				       &derived_header, &derived_volume_table));
	zassert_equal(-EINVAL,
		      ubi_impl_key_derive(ikm_key, NULL, 1, &derived_header,
					  &derived_volume_table));
	zassert_equal(PSA_KEY_ID_NULL, derived_header);
	zassert_equal(PSA_KEY_ID_NULL, derived_volume_table);
}
```
